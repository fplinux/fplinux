// SPDX-License-Identifier: GPL-2.0-only
#include "ums9117-bluetooth.dtsi"

&bluetooth {
	firmware-name = "ums9117/nokia110-cm4.bin",
			"ums9117/nokia110-bt-config.bin",
			"ums9117/nokia110-bt-sprd.bin",
			"ums9117/nokia110-bt-rf-config.bin";
	fplinux,fm-config-name = "fplinux/nokia110-fm-config.bin";
};
