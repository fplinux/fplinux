// SPDX-License-Identifier: GPL-2.0-only
/dts-v1/;

#include "ums9117-u-boot.dtsi"

/ {
	compatible = "uniwa,v1000-4g", "sprd,ums9117";
	model = "UNIWA V1000 4G U-Boot control tree";
};

&{/mmc@20300000} {
	non-removable;
};
