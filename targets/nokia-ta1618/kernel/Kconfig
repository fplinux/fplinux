## targets/nokia-ta1618/kernel/Kconfig
```kconfig
# SPDX-License-Identifier: GPL-2.0-only
if ARCH_UMS9117

config MACH_NOKIA_TA1618
	bool "Nokia 3210 4G (TA-1618)"
	select FB_IOMEM_HELPERS if FB
	select GPIOLIB
	select GPIO_PMIC_EIC_SPRD
	select MFD_SYSCON
	help
	  Board support for the Nokia 3210 4G (TA-1618), a UMS9117
	  feature phone with 64 MiB of DRAM, a 240x320 panel and a matrix
	  keypad. BootROM/FDL USB loading supports a RAM system or U-Boot
	  with a microSD system root. Internal NAND remains read-only. The
	  low 2 MiB of DRAM belong to CM4; the top 2 MiB stay reserved for
	  DTB staging and the display buffer.

config FB_TA1618_DMA_MEMCPY
	bool "AP DMA framebuffer copy on Nokia TA-1618"
	depends on FB_TA1618 && UMS9117_DMA
	help
	  Copy completed framebuffer pages into the LCDC transfer buffer with
	  one AP DMAengine memory-copy channel. DMA completion is awaited
	  before the LCDC scans the copied frame. Disable to use CPU copies and
	  leave every AP DMA channel available to other clients.

endif
```

## targets/nokia-ta1618/kernel/defconfig
```kconfig
CONFIG_LOCALVERSION="-fplinux"
# CONFIG_LOCALVERSION_AUTO is not set
CONFIG_KERNEL_XZ=y
CONFIG_DEFAULT_HOSTNAME="ta1618"
CONFIG_SYSVIPC=y
CONFIG_BLK_DEV_INITRD=y
CONFIG_CC_OPTIMIZE_FOR_SIZE=y
CONFIG_LD_DEAD_CODE_DATA_ELIMINATION=y
CONFIG_EXPERT=y
# CONFIG_FHANDLE is not set
# CONFIG_POSIX_TIMERS is not set
# CONFIG_AIO is not set
# CONFIG_IO_URING is not set
# CONFIG_ADVISE_SYSCALLS is not set
# CONFIG_MEMBARRIER is not set
# CONFIG_RSEQ is not set
# CONFIG_CACHESTAT_SYSCALL is not set
CONFIG_ARCH_UMS9117=y
CONFIG_MACH_NOKIA_TA1618=y
CONFIG_THUMB2_KERNEL=y
# CONFIG_ATAGS is not set
CONFIG_VFP=y
CONFIG_KPROBES=y
# CONFIG_SECCOMP is not set
# CONFIG_STACKPROTECTOR is not set
CONFIG_MODULES=y
CONFIG_MODULE_UNLOAD=y
CONFIG_PARTITION_ADVANCED=y
# CONFIG_COREDUMP is not set
CONFIG_SLUB_TINY=y
# CONFIG_COMPAT_BRK is not set
# CONFIG_VM_EVENT_COUNTERS is not set
CONFIG_NET=y
CONFIG_PACKET=y
CONFIG_INET=y
# CONFIG_IPV6 is not set
CONFIG_DEVTMPFS=y
CONFIG_DEVTMPFS_MOUNT=y
# CONFIG_STANDALONE is not set
# CONFIG_PREVENT_FIRMWARE_BUILD is not set
# CONFIG_FW_LOADER is not set
# CONFIG_ALLOW_DEV_COREDUMP is not set
CONFIG_NETDEVICES=y
CONFIG_INPUT_EVDEV=y
CONFIG_KEYBOARD_UMS9117=y
# CONFIG_INPUT_MOUSE is not set
CONFIG_INPUT_MISC=y
CONFIG_INPUT_UINPUT=y
CONFIG_INPUT_TA1618_SC2720_VIBRATOR=y
# CONFIG_HW_RANDOM is not set
# CONFIG_DEVMEM is not set
# CONFIG_DEVPORT is not set
# CONFIG_GPIO_CDEV is not set
CONFIG_POWER_SUPPLY=y
CONFIG_POWER_SUPPLY_TA1618_SC2720_CHARGER=y
CONFIG_POWER_SUPPLY_TA1618_SC2720_FGU=y
# CONFIG_HWMON is not set
CONFIG_THERMAL=y
# CONFIG_THERMAL_OF is not set
CONFIG_TA1618_THM1_THERMAL=y
CONFIG_REGULATOR=y
CONFIG_REGULATOR_SC2720_USB33=y
CONFIG_FB=y
CONFIG_FB_TA1618=y
CONFIG_FRAMEBUFFER_CONSOLE=y
CONFIG_FRAMEBUFFER_CONSOLE_DETECT_PRIMARY=y
# CONFIG_HID is not set
CONFIG_USB_MUSB_HDRC=y
CONFIG_USB_MUSB_UMS9117=y
CONFIG_MUSB_PIO_ONLY=y
CONFIG_USB_GADGET=y
CONFIG_USB_CONFIGFS=y
CONFIG_USB_CONFIGFS_SERIAL=y
CONFIG_USB_CONFIGFS_NCM=y
CONFIG_MMC=y
CONFIG_MMC_TA1618=y
CONFIG_NEW_LEDS=y
CONFIG_LEDS_CLASS=y
CONFIG_LEDS_TA1618_KPLED=y
CONFIG_RTC_CLASS=y
# CONFIG_RTC_HCTOSYS is not set
# CONFIG_RTC_SYSTOHC is not set
# CONFIG_RTC_NVMEM is not set
CONFIG_RTC_DRV_TA1618_SC2720=y
# CONFIG_VIRTIO_MENU is not set
# CONFIG_VHOST_MENU is not set
CONFIG_SPRD_UMS9117_INHERITED_CLK=y
CONFIG_IIO=y
CONFIG_IIO_TA1618_SC2720_AUXADC=y
# CONFIG_DNOTIFY is not set
# CONFIG_INOTIFY_USER is not set
CONFIG_VFAT_FS=y
CONFIG_TMPFS=y
# CONFIG_MISC_FILESYSTEMS is not set
CONFIG_NLS_CODEPAGE_437=y
CONFIG_NLS_ISO8859_1=y
# CONFIG_CRC_OPTIMIZATIONS is not set
CONFIG_FONTS=y
CONFIG_FONT_7x14=y
CONFIG_PRINTK_TIME=y
# CONFIG_SYMBOLIC_ERRNAME is not set
# CONFIG_DEBUG_MISC is not set
# CONFIG_SECTION_MISMATCH_WARN_ONLY is not set
CONFIG_DEBUG_FS=y
CONFIG_IRQSOFF_TRACER=y
# CONFIG_RUNTIME_TESTING_MENU is not set
```

## targets/nokia-ta1618/linux/arch/arm/mach-ums9117/Kconfig
```kconfig
# SPDX-License-Identifier: GPL-2.0-only
if ARCH_UMS9117

config MACH_NOKIA_TA1618
	bool "Nokia 3210 4G (TA-1618)"
	select GPIOLIB
	select GPIO_PMIC_EIC_SPRD
	select MFD_SYSCON
	help
	  Board support for the Nokia 3210 4G (TA-1618), a UMS9117
	  feature phone with 64 MiB of DRAM, a 240x320 panel and a matrix
	  keypad. BootROM/FDL USB loading supports a RAM system or U-Boot
	  with a microSD system root. Internal NAND remains read-only. The
	  low 2 MiB of DRAM belong to CM4; the top 2 MiB stay reserved for
	  DTB staging and the display buffer.

endif
```

## targets/nokia-ta1618/profiles/microsd-uboot/uboot/ta1618_defconfig
```kconfig
CONFIG_ARM=y
CONFIG_TARGET_FPLINUX_TA1618=y
CONFIG_SYS_MALLOC_F_LEN=0x4000
CONFIG_SYS_MALLOC_LEN=0x100000
CONFIG_NR_DRAM_BANKS=1
CONFIG_DEFAULT_DEVICE_TREE="ums9117-ta1618-u-boot"
CONFIG_FIT=y
CONFIG_SHA256=y
# CONFIG_FIT_SIGNATURE is not set
# CONFIG_LEGACY_IMAGE_FORMAT is not set
CONFIG_ENV_SIZE=0x1000
CONFIG_BOOTDELAY=-2
CONFIG_USE_BOOTCOMMAND=y
CONFIG_BOOTCOMMAND="sdboot"
# CONFIG_BOOTSTD is not set
# CONFIG_DISPLAY_CPUINFO is not set
# CONFIG_DISPLAY_BOARDINFO is not set
CONFIG_OF_SEPARATE=y
CONFIG_ENV_IS_NOWHERE=y
CONFIG_SYS_ICACHE_OFF=y
CONFIG_SYS_DCACHE_OFF=y
# CONFIG_CMD_BOOTD is not set
CONFIG_CMD_BOOTM=y
# CONFIG_CMD_BOOTI is not set
# CONFIG_CMD_BOOTZ is not set
# CONFIG_CMD_ELF is not set
# CONFIG_CMD_GO is not set
# CONFIG_CMD_RUN is not set
# CONFIG_CMD_SOURCE is not set
# CONFIG_CMD_EDITENV is not set
# CONFIG_CMD_LOADB is not set
# CONFIG_CMD_LOADS is not set
# CONFIG_CMD_MEMORY is not set
# CONFIG_CMD_ITEST is not set
# CONFIG_CMD_SETEXPR is not set
# CONFIG_CMD_SLEEP is not set
# CONFIG_CMD_FDT is not set
# CONFIG_CMD_FAT is not set
# CONFIG_CMD_FS_GENERIC is not set
CONFIG_FS_FAT=y
CONFIG_DOS_PARTITION=y
# CONFIG_NET is not set
# CONFIG_BLOCK_CACHE is not set
CONFIG_MMC=y
CONFIG_DM_MMC=y
# CONFIG_CMD_MMC is not set
# CONFIG_MMC_WRITE is not set
# CONFIG_MMC_HW_PARTITIONING is not set
# CONFIG_FAT_WRITE is not set
# CONFIG_USB is not set
# CONFIG_EFI_LOADER is not set
```

## targets/nokia-ta1618/profiles/nand-ro-lab/kernel/Kconfig
```kconfig
# SPDX-License-Identifier: GPL-2.0-only
config TA1618_NANDC_RO_LAB
	bool "Nokia TA-1618 read-only NANDC diagnostic"
	depends on MACH_NOKIA_TA1618 && HAS_DMA && !MTD && !SPI
	help
	  Enable read-only access to the Nokia TA-1618 internal NAND in the
	  nand-ro-lab profile. After checking the NAND identity and feature state,
	  the driver exposes one physical stream containing every page's main and
	  OOB bytes. It provides no MTD, generic SPI, ioctl, mmap, feature-write,
	  program or erase operation.
```

## targets/nokia-ta1618/rootfs/defconfig
```kconfig
BR2_arm=y
BR2_cortex_a7=y
BR2_ARM_ENABLE_NEON=y
BR2_ARM_ENABLE_VFP=y
BR2_ARM_FPU_VFPV4=y
BR2_ARM_EABIHF=y
BR2_TOOLCHAIN_BUILDROOT_MUSL=y
BR2_KERNEL_HEADERS_VERSION=y
BR2_DEFAULT_KERNEL_VERSION="6.18.40"
BR2_PACKAGE_HOST_LINUX_HEADERS_CUSTOM_6_18=y
BR2_GLOBAL_PATCH_DIR="$(BR2_EXTERNAL_FPLINUX_PATH)/patches"
BR2_DOWNLOAD_FORCE_CHECK_HASHES=y
BR2_REPRODUCIBLE=y
BR2_TARGET_GENERIC_HOSTNAME="ta1618"
BR2_TARGET_GENERIC_ISSUE="FPLinux TA-1618 RAM system"
BR2_INIT_NONE=y
BR2_ROOTFS_DEVICE_CREATION_DYNAMIC_DEVTMPFS=y
# BR2_TARGET_GENERIC_GETTY is not set
BR2_ROOTFS_OVERLAY="/workspace/common/rootfs/overlay /workspace/targets/nokia-ta1618/rootfs/overlay"
BR2_ROOTFS_POST_BUILD_SCRIPT="/workspace/buildroot-external/post-build.sh"
BR2_PACKAGE_BUSYBOX=y
BR2_PACKAGE_FPLINUX_CONSOLE=y
BR2_PACKAGE_FPLINUX_INPUT=y
BR2_PACKAGE_FPLINUX_CPUCLOCK=y
BR2_TARGET_ROOTFS_CPIO=y
# BR2_TARGET_ROOTFS_TAR is not set
```

## targets/uniwa-v1000-4g/linux/arch/arm/mach-ums9117/Kconfig
```kconfig
# SPDX-License-Identifier: GPL-2.0-only
if ARCH_UMS9117

config MACH_UNIWA_V1000_4G
	bool "UNIWA V1000 4G"
	select GPIOLIB
	select GPIO_PMIC_EIC_SPRD
	select MFD_SYSCON
	help
	  Board support for the UMS9117-based UNIWA V1000 4G.
	  The USB loader starts Linux with a RAM or microSD system root.
	  Control the phone through the authenticated USB connection.
	  Internal NAND is available through a read-only backup interface.

endif
```

## targets/xiaomi-qin-1s-plus/linux/overlay/Documentation/devicetree/bindings/display/panel/xiaomi,qin1splus-gc9307.yaml
```yaml
# SPDX-License-Identifier: (GPL-2.0-only OR BSD-2-Clause)
%YAML 1.2
---
$id: http://devicetree.org/schemas/display/panel/xiaomi,qin1splus-gc9307.yaml#
$schema: http://devicetree.org/meta-schemas/core.yaml#

title: Qin 1s+ GC9307 display

maintainers:
  - FPLinux <fplinux@users.noreply.github.com>

allOf:
  - $ref: panel-common.yaml#
  - $ref: /schemas/spi/spi-peripheral-props.yaml#

properties:
  compatible:
    const: xiaomi,qin1splus-gc9307

  reg:
    maxItems: 1

  spi-max-frequency:
    maximum: 96000000

  dc-gpios:
    maxItems: 1
    description: Data/command selection, high for data.

  te-gpios:
    maxItems: 1
    description: Display synchronization input, sampled on its physical rising edge.

  write-only:
    type: boolean
    description: Only display writes are supported.

  format:
    const: r5g6b5

  width-mm:
    description: Physical display width, zero if unknown.

  height-mm:
    description: Physical display height, zero if unknown.

required:
  - compatible
  - reg
  - spi-max-frequency
  - dc-gpios
  - reset-gpios
  - write-only
  - backlight
  - format
  - width-mm
  - height-mm
  - panel-timing

unevaluatedProperties: false
```

## targets/xiaomi-qin-1s-plus/linux/overlay/Documentation/devicetree/bindings/net/bluetooth/fplinux,qin1splus-bluetooth.yaml
```yaml
# SPDX-License-Identifier: (GPL-2.0-only OR BSD-2-Clause)
%YAML 1.2
---
$id: http://devicetree.org/schemas/net/bluetooth/fplinux,qin1splus-bluetooth.yaml#
$schema: http://devicetree.org/meta-schemas/core.yaml#

title: Qin 1s+ shared-buffer Bluetooth endpoint

maintainers:
  - FPLinux contributors <313246064+fplinux-dev@users.noreply.github.com>

description:
  Fixed board Bluetooth endpoint using the existing WCN transport and BTWF
  power owner. Registering the HCI device schedules native controller setup.

properties:
  $nodename:
    const: bluetooth

  compatible:
    const: fplinux,qin1splus-bluetooth

  remoteproc:
    $ref: /schemas/types.yaml#/definitions/phandle
    description: The Qin BTWF remote processor supplying the power reference.

  fplinux,sipc:
    $ref: /schemas/types.yaml#/definitions/phandle
    description: The single fixed shared-buffer owner.

required:
  - compatible
  - remoteproc
  - fplinux,sipc

additionalProperties: false
```

## targets/xiaomi-qin-1s-plus/linux/overlay/Documentation/devicetree/bindings/remoteproc/fplinux,qin1splus-btwf.yaml
```yaml
# SPDX-License-Identifier: (GPL-2.0-only OR BSD-2-Clause)
%YAML 1.2
---
$id: http://devicetree.org/schemas/remoteproc/fplinux,qin1splus-btwf.yaml#
$schema: http://devicetree.org/meta-schemas/core.yaml#

title: Qin 1s+ integrated BTWF remote processor

maintainers:
  - FPLinux contributors <313246064+fplinux-dev@users.noreply.github.com>

description: |
  One explicitly started BTWF core using a raw image and fixed shared-memory
  calibration ABI and a separate shared-buffer transport. It has no GNSS owner.
  Its reserved-memory region must be no-map and span 0x280000 bytes starting
  at 0x88000000. This owner maps its first 0x180000 bytes; the shared-buffer
  transport maps the remaining 1 MiB.

properties:
  compatible:
    const: fplinux,qin1splus-btwf

  memory-region:
    maxItems: 1

  fplinux,sipc:
    $ref: /schemas/types.yaml#/definitions/phandle
    description: WCN transport prepared before CPU release and stopped after reset.

  sprd,aon-syscon:
    $ref: /schemas/types.yaml#/definitions/phandle
    description: Shared AON registers including WCN enable and chip identity.

  sprd,pmu-syscon:
    $ref: /schemas/types.yaml#/definitions/phandle
    description: Shared PMU registers including WCN power, sleep and reset aliases.

  sprd,pub-syscon:
    $ref: /schemas/types.yaml#/definitions/phandle
    description: PUB registers containing the low 16 bits of DMC dummy register 0.

  sprd,g6-syscon:
    $ref: /schemas/types.yaml#/definitions/phandle
    description: Shared G6 registers containing the WCN 26 MHz control field.

  vddcon-supply: true

  vddwifipa-supply: true

  nvmem-cells:
    minItems: 2
    maxItems: 2

  nvmem-cell-names:
    items:
      - const: wifi-calibration
      - const: temperature-calibration

required:
  - compatible
  - memory-region
  - fplinux,sipc
  - sprd,aon-syscon
  - sprd,pmu-syscon
  - sprd,pub-syscon
  - sprd,g6-syscon
  - vddcon-supply
  - vddwifipa-supply
  - nvmem-cells
  - nvmem-cell-names

additionalProperties: false
```

## targets/xiaomi-qin-1s-plus/linux/overlay/Documentation/devicetree/bindings/soc/sprd/fplinux,qin1splus-sipc.yaml
```yaml
# SPDX-License-Identifier: (GPL-2.0-only OR BSD-2-Clause)
%YAML 1.2
---
$id: http://devicetree.org/schemas/soc/sprd/fplinux,qin1splus-sipc.yaml#
$schema: http://devicetree.org/meta-schemas/core.yaml#

title: Qin 1s+ WCN shared-buffer transport

maintainers:
  - FPLinux contributors <313246064+fplinux-dev@users.noreply.github.com>

description: |
  Fixed WCN mailbox and shared-buffer handshake owner. The memory-region is
  the existing no-map 0x88000000/0x280000 reservation; only its final 1 MiB,
  starting at 0x88180000, belongs to this transport. The BTWF boot owner
  controls when this transport may initialize memory and release its channel.

properties:
  compatible:
    const: fplinux,qin1splus-sipc

  memory-region:
    maxItems: 1

  mboxes:
    maxItems: 1
    description: WCN mailbox core 5; the logical SIPC destination is 3.

required:
  - compatible
  - memory-region
  - mboxes

additionalProperties: false
```
