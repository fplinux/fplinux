## targets/xiaomi-qin-1s-plus/linux/overlay/Documentation/devicetree/bindings/sound/fplinux,qin1splus-capture.yaml
```yaml
# SPDX-License-Identifier: GPL-2.0-only
%YAML 1.2
---
$id: http://devicetree.org/schemas/sound/fplinux,qin1splus-capture.yaml#
$schema: http://devicetree.org/meta-schemas/core.yaml#

title: Qin 1s+ SC2721 and SC9820E PCM

maintainers:
  - FPLinux <fplinux@users.noreply.github.com>

description: |
  A child of the SC2721 SPI PMIC. The parent supplies the ADI regmap.
  This PCM controller exclusively owns the digital codec and VBC banks,
  borrows the shared AON, PMU and G6 syscons, and reads the clock status word.
  It provides 48 kHz, signed 16-bit little endian mono MainMIC capture and
  mutually exclusive stereo playback at 44.1 or 48 kHz. A prepared profile
  supplies the microphone gain and 44.1 kHz speaker EQ6, ALC and base gains.
  The 48 kHz playback path bypasses that processing. The card is unavailable
  until the profile is supplied. Playback preparation checks the analog
  headphone path with both channel gains muted. Playback START enables the
  referenced speaker amplifier and applies the selected master volume.

properties:
  compatible:
    const: fplinux,qin1splus-capture

  reg:
    maxItems: 1

  interrupts:
    maxItems: 1

  firmware-name:
    const: qin1splus-audio-profile.bin
    description: Prepared normal speaker processing and MainMIC gain.

  fplinux,speaker-amplifier:
    $ref: /schemas/types.yaml#/definitions/phandle
    description: AW87339 speaker amplifier client owned by its I2C driver.

  sprd,aon-syscon:
    $ref: /schemas/types.yaml#/definitions/phandle
    description: Shared AON APB syscon.

  sprd,pmu-syscon:
    $ref: /schemas/types.yaml#/definitions/phandle
    description: PMU syscon covering XTLBUF1_REL_CFG at offset 0x90.

  sprd,g6-syscon:
    $ref: /schemas/types.yaml#/definitions/phandle
    description: G6 syscon covering the sine driver register at offset 0x8.

  sprd,digital-codec:
    $ref: /schemas/types.yaml#/definitions/phandle
    description: Digital codec bank, with a single 0x2000-byte resource.

  sprd,vbc:
    $ref: /schemas/types.yaml#/definitions/phandle
    description: VBC r1p0v3 bank, with a single 0x10000-byte resource.

  sprd,clock-stable:
    $ref: /schemas/types.yaml#/definitions/phandle
    description: Single read-only 32-bit clock-stability status resource.

required:
  - compatible
  - reg
  - interrupts
  - firmware-name
  - fplinux,speaker-amplifier
  - sprd,aon-syscon
  - sprd,pmu-syscon
  - sprd,g6-syscon
  - sprd,digital-codec
  - sprd,vbc
  - sprd,clock-stable

additionalProperties: false
```

## targets/xiaomi-qin-1s-plus/linux/overlay/Documentation/devicetree/bindings/usb/fplinux,qin1splus-musb-inherited.yaml
```yaml
# SPDX-License-Identifier: (GPL-2.0-only OR BSD-2-Clause)
%YAML 1.2
---
$id: http://devicetree.org/schemas/usb/fplinux,qin1splus-musb-inherited.yaml#
$schema: http://devicetree.org/meta-schemas/core.yaml#

title: Qin 1s+ inherited MUSB peripheral controller

maintainers:
  - FPLinux contributors <313246064+fplinux-dev@users.noreply.github.com>

description: |
  The RAM boot path must provide the controller clocks, PHY power and
  stopped DMA channels before Linux takes ownership. The glue uses
  programmed I/O and supports peripheral mode only; it does not initialize
  the clocks or PHY.

properties:
  compatible:
    const: fplinux,qin1splus-musb-inherited

  reg:
    maxItems: 1
    description: The 0x2000-byte MUSB controller register block.

  interrupts:
    maxItems: 1

  interrupt-names:
    const: mc

  dr_mode:
    const: peripheral

required:
  - compatible
  - reg
  - interrupts
  - interrupt-names
  - dr_mode

additionalProperties: false

examples:
  - |
    #include <dt-bindings/interrupt-controller/arm-gic.h>

    usb@20200000 {
        compatible = "fplinux,qin1splus-musb-inherited";
        reg = <0x20200000 0x2000>;
        interrupts = <GIC_SPI 55 IRQ_TYPE_LEVEL_HIGH>;
        interrupt-names = "mc";
        dr_mode = "peripheral";
    };
```

## targets/xiaomi-qin-1s-plus/linux/overlay/sound/drivers/qin1splus/Kconfig
```kconfig
# SPDX-License-Identifier: GPL-2.0-only
config SND_QIN1SPLUS_CAPTURE
	bool "Qin 1s+ SC9820E SC2721 PCM"
	depends on SND_DRIVERS && ARCH_SC9820E && OF && MFD_SC27XX_PMIC
	depends on AW87339=y
	select SND_PCM
	select MFD_SYSCON
	help
	  Capture the built-in MainMIC through SC2721 ADCL and SC9820E VBC
	  ADC0 using programmed I/O. The stream is 48 kHz, S16_LE, mono.
	  The fixed route owns the digital codec and VBC banks exclusively.
	  Digital stereo playback uses the same banks at 44.1 or 48 kHz,
	  S16_LE. Prepared speaker EQ6 and ALC apply at 44.1 kHz; the 48 kHz
	  path bypasses those processing blocks. Audio requires a prepared
	  target profile, including the built-in microphone gain.
	  Capture and playback are mutually exclusive. Playback prepares the
	  analog headphone path while muted and enables the external speaker
	  amplifier at START. A master volume controls both headphone gains.
```

## tests/host_tool/sc27xx/Kconfig.fixture
```kconfig
# SPDX-License-Identifier: GPL-2.0-only
	 via I2C bus. S5M8767A have 9 Bucks and 28 LDOs output and
	 supports DVS mode with 8bits of output voltage control.

config REGULATOR_SC2731
	tristate "Spreadtrum SC2731 power regulator driver"
	depends on MFD_SC27XX_PMIC || COMPILE_TEST
	help
	  This driver provides support for the voltage regulators on the
	  SC2731 PMIC.

config REGULATOR_SGM3804
	tristate "SGMicro SGM3804 voltage regulator"
```

## tests/host_tool/sc9820e/clocks/gpio-source/Kconfig.fixture
```kconfig
# SPDX-License-Identifier: GPL-2.0-only

config GPIO_SPRD
	tristate "Spreadtrum GPIO support"
	depends on ARCH_SPRD || COMPILE_TEST
	select GPIOLIB_IRQCHIP
	help
	  Say yes here to support Spreadtrum GPIO device.
```
