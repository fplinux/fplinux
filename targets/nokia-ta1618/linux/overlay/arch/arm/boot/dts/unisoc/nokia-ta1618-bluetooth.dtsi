// SPDX-License-Identifier: GPL-2.0-only
#include "ums9117-bluetooth.dtsi"

&bluetooth {
	firmware-name = "ums9117/ta1618-cm4.bin",
			"ums9117/ta1618-bt-config.bin",
			"ums9117/ta1618-bt-sprd.bin",
			"ums9117/ta1618-bt-rf-config.bin";
	fplinux,fm-config-name = "fplinux/ta1618-fm-config.bin";
};
