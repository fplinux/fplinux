// SPDX-License-Identifier: GPL-2.0-only
#include "ums9117-bluetooth.dtsi"

&bluetooth {
	firmware-name = "ums9117/inoi244-cm4.bin",
			"ums9117/inoi244-bt-config.bin",
			"ums9117/inoi244-bt-sprd.bin",
			"ums9117/inoi244-bt-rf-config.bin";
	fplinux,fm-config-name = "fplinux/inoi244-fm-config.bin";
};
