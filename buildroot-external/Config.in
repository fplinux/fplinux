## platforms/sc9820e/linux/overlay/Documentation/devicetree/bindings/input/fplinux,sc9820e-keypad.yaml
```yaml
# SPDX-License-Identifier: (GPL-2.0-only OR BSD-2-Clause)
%YAML 1.2
---
$id: http://devicetree.org/schemas/input/fplinux,sc9820e-keypad.yaml#
$schema: http://devicetree.org/meta-schemas/core.yaml#

title: SC9820E v1 matrix keypad

maintainers:
  - FPLinux <fplinux@users.noreply.github.com>

allOf:
  - $ref: matrix-keymap.yaml#

properties:
  compatible:
    const: fplinux,sc9820e-keypad

  reg:
    maxItems: 1

  interrupts:
    maxItems: 1

  keypad,num-rows:
    minimum: 1
    maximum: 8

  keypad,num-columns:
    minimum: 1
    maximum: 8

  linux,keymap:
    minItems: 1
    maxItems: 64

  fplinux,aon-syscon:
    $ref: /schemas/types.yaml#/definitions/phandle
    description: Shared AON register map with atomic set and clear aliases.

  fplinux,debounce-count:
    $ref: /schemas/types.yaml#/definitions/uint32
    description: Raw debounce counter value written to the controller.

required:
  - compatible
  - reg
  - interrupts
  - keypad,num-rows
  - keypad,num-columns
  - linux,keymap
  - fplinux,aon-syscon
  - fplinux,debounce-count

unevaluatedProperties: false
```

## platforms/sc9820e/linux/overlay/Documentation/devicetree/bindings/leds/backlight/sprd,sc2721-backlight.yaml
```yaml
# SPDX-License-Identifier: (GPL-2.0-only OR BSD-2-Clause)
%YAML 1.2
---
$id: http://devicetree.org/schemas/leds/backlight/sprd,sc2721-backlight.yaml#
$schema: http://devicetree.org/meta-schemas/core.yaml#

title: SC2721 current-controlled LCD backlight

maintainers:
  - FPLinux <fplinux@users.noreply.github.com>

properties:
  compatible:
    const: sprd,sc2721-bltc-rgb

  reg:
    maxItems: 1

required:
  - compatible
  - reg

additionalProperties: false
```

## platforms/sc9820e/linux/overlay/Documentation/devicetree/bindings/leds/sprd,sc2721-kpled.yaml
```yaml
# SPDX-License-Identifier: (GPL-2.0-only OR BSD-2-Clause)
%YAML 1.2
---
$id: http://devicetree.org/schemas/leds/sprd,sc2721-kpled.yaml#
$schema: http://devicetree.org/meta-schemas/core.yaml#

title: SC2721 keypad backlight in LDO mode

maintainers:
  - FPLinux <fplinux@users.noreply.github.com>

allOf:
  - $ref: common.yaml#

properties:
  compatible:
    const: sprd,sc2721-kpled-ldo

  reg:
    maxItems: 1
    description: KPLED_CTRL0 offset within the PMIC, followed by KPLED_CTRL1

  function:
    const: kbd_backlight

required:
  - compatible
  - reg
  - function

unevaluatedProperties: false
```

## platforms/sc9820e/linux/overlay/Documentation/devicetree/bindings/mfd/fplinux,sc9820e-aon-atomic.yaml
```yaml
# SPDX-License-Identifier: (GPL-2.0-only OR BSD-2-Clause)
%YAML 1.2
---
$id: http://devicetree.org/schemas/mfd/fplinux,sc9820e-aon-atomic.yaml#
$schema: http://devicetree.org/meta-schemas/core.yaml#

title: SC9820E shared AON register bank

maintainers:
  - FPLinux contributors <313246064+fplinux-dev@users.noreply.github.com>

description: |
  Shared AON control registers and their atomic set and clear aliases.
  Clock, GPIO, keypad and microphone capture consumers access this bank
  through their AON syscon phandles.

properties:
  compatible:
    items:
      - const: fplinux,sc9820e-aon-atomic
      - const: syscon

  reg:
    maxItems: 1

required:
  - compatible
  - reg

additionalProperties: false
```

## platforms/sc9820e/linux/overlay/Documentation/devicetree/bindings/mfd/fplinux,sc9820e-ap-ahb.yaml
```yaml
# SPDX-License-Identifier: (GPL-2.0-only OR BSD-2-Clause)
%YAML 1.2
---
$id: http://devicetree.org/schemas/mfd/fplinux,sc9820e-ap-ahb.yaml#
$schema: http://devicetree.org/meta-schemas/core.yaml#

title: SC9820E peripheral bus enable registers

maintainers:
  - FPLinux <fplinux@users.noreply.github.com>

properties:
  compatible:
    items:
      - enum:
          - fplinux,sc9820e-ap-ahb
          - fplinux,sc9820e-ap-apb
      - const: syscon

  reg:
    maxItems: 1

required:
  - compatible
  - reg

additionalProperties: false
```

## platforms/sc9820e/linux/overlay/Documentation/devicetree/bindings/mfd/fplinux,sc9820e-audio-g6.yaml
```yaml
# SPDX-License-Identifier: (GPL-2.0-only OR BSD-2-Clause)
%YAML 1.2
---
$id: http://devicetree.org/schemas/mfd/fplinux,sc9820e-audio-g6.yaml#
$schema: http://devicetree.org/meta-schemas/core.yaml#

title: SC9820E shared G6 register window

maintainers:
  - FPLinux contributors <313246064+fplinux-dev@users.noreply.github.com>

description: |
  Shared register window containing the audio sine-driver control and WCN
  26 MHz control. Consumers access their fields through a sprd,g6-syscon
  phandle and preserve unrelated fields.

properties:
  compatible:
    items:
      - const: fplinux,sc9820e-audio-g6
      - const: syscon

  reg:
    maxItems: 1

required:
  - compatible
  - reg

additionalProperties: false
```

## platforms/sc9820e/linux/overlay/Documentation/devicetree/bindings/mfd/fplinux,sc9820e-audio-pmu.yaml
```yaml
# SPDX-License-Identifier: (GPL-2.0-only OR BSD-2-Clause)
%YAML 1.2
---
$id: http://devicetree.org/schemas/mfd/fplinux,sc9820e-audio-pmu.yaml#
$schema: http://devicetree.org/meta-schemas/core.yaml#

title: SC9820E shared PMU register window

maintainers:
  - FPLinux contributors <313246064+fplinux-dev@users.noreply.github.com>

description: |
  Shared PMU registers for audio oscillator requests and WCN power, reset
  and sleep controls. Consumers access their fields through a
  sprd,pmu-syscon phandle, including SET and CLEAR aliases.

properties:
  compatible:
    items:
      - const: fplinux,sc9820e-audio-pmu
      - const: syscon

  reg:
    maxItems: 1

required:
  - compatible
  - reg

additionalProperties: false
```

## platforms/sc9820e/linux/overlay/Documentation/devicetree/bindings/mfd/fplinux,sc9820e-pub.yaml
```yaml
# SPDX-License-Identifier: (GPL-2.0-only OR BSD-2-Clause)
%YAML 1.2
---
$id: http://devicetree.org/schemas/mfd/fplinux,sc9820e-pub.yaml#
$schema: http://devicetree.org/meta-schemas/core.yaml#

title: SC9820E public memory controller registers

maintainers:
  - FPLinux <fplinux@users.noreply.github.com>

description: |
  Shared PUB registers include the memory-controller dummy word used during
  connectivity processor startup. Consumers receive this register map through
  a phandle and preserve fields owned by other users.

properties:
  compatible:
    items:
      - const: fplinux,sc9820e-pub
      - const: syscon

  reg:
    maxItems: 1

required:
  - compatible
  - reg

additionalProperties: false
```

## platforms/sc9820e/linux/overlay/Documentation/devicetree/bindings/misc/awinic,aw87339.yaml
```yaml
# SPDX-License-Identifier: (GPL-2.0-only OR BSD-2-Clause)
%YAML 1.2
---
$id: http://devicetree.org/schemas/misc/awinic,aw87339.yaml#
$schema: http://devicetree.org/meta-schemas/core.yaml#

title: Awinic AW87339 amplifier

maintainers:
  - FPLinux <fplinux@users.noreply.github.com>

properties:
  compatible:
    const: awinic,aw87339

  reg:
    maxItems: 1

  reset-gpios:
    maxItems: 1
    description: Active-low hardware reset input.

required:
  - compatible
  - reg
  - reset-gpios

additionalProperties: false
```

## platforms/sc9820e/linux/overlay/Documentation/devicetree/bindings/mmc/sprd,sdhc-r10.yaml
```yaml
# SPDX-License-Identifier: (GPL-2.0-only OR BSD-2-Clause)
%YAML 1.2
---
$id: http://devicetree.org/schemas/mmc/sprd,sdhc-r10.yaml#
$schema: http://devicetree.org/meta-schemas/core.yaml#

title: Spreadtrum r10 SD and read-only eMMC controllers

maintainers:
  - FPLinux <fplinux@users.noreply.github.com>

allOf:
  - $ref: sdhci-common.yaml#
  - if:
      properties:
        compatible:
          contains:
            const: fplinux,sc9820e-emmc-ro
    then:
      properties:
        bus-width:
          const: 1
        no-mmc: false
        no-sd: true
        non-removable: true
        vqmmc-supply: false
        cap-mmc-hw-reset: false
      required:
        - bus-width
        - no-sd
        - non-removable
    else:
      properties:
        no-sd: false
        non-removable: false
      required:
        - no-mmc
        - vqmmc-supply

properties:
  compatible:
    oneOf:
      - const: sprd,sdhc-r10
      - items:
          - const: fplinux,sc9820e-emmc-ro
          - const: sprd,sdhc-r10

  reg:
    maxItems: 1

  interrupts:
    maxItems: 1

  clocks:
    items:
      - description: SDIO source multiplexer
      - description: 26 MHz oscillator input
      - description: AP-AHB gate

  clock-names:
    items:
      - const: sdio_clk
      - const: sdio_clk_source
      - const: sdio_ahb_enable

  bus-width:
    enum: [1, 4]

  max-frequency:
    maximum: 13000000

  voltage-ranges:
    $ref: /schemas/types.yaml#/definitions/uint32-matrix
    maxItems: 1
    items:
      items:
        - description: Minimum slot voltage in mV
          const: 3000
        - description: Maximum slot voltage in mV
          const: 3000

  non-removable: true
  no-sd: true
  no-mmc: true
  no-sdio: true
  no-1-8-v: true
  vmmc-supply: true
  vqmmc-supply: true

required:
  - compatible
  - reg
  - interrupts
  - clocks
  - clock-names
  - max-frequency
  - no-sdio
  - no-1-8-v
  - vmmc-supply

unevaluatedProperties: false
```

## platforms/sc9820e/linux/overlay/Documentation/devicetree/bindings/power/reset/sprd,sc2721-poweroff.yaml
```yaml
# SPDX-License-Identifier: GPL-2.0-only OR BSD-2-Clause
%YAML 1.2
---
$id: http://devicetree.org/schemas/power/reset/sprd,sc2721-poweroff.yaml#
$schema: http://devicetree.org/meta-schemas/core.yaml#

title: SC2721 system power-off

maintainers:
  - FPLinux contributors <313246064+fplinux-dev@users.noreply.github.com>

description: Power-off control inside an SC2721 PMIC accessed through SC9820E ADI.

properties:
  compatible:
    const: sprd,sc2721-poweroff

required:
  - compatible

additionalProperties: false

examples:
  - |
    poweroff {
        compatible = "sprd,sc2721-poweroff";
    };
```

## platforms/sc9820e/linux/overlay/Documentation/devicetree/bindings/regulator/sprd,sc2721-regulator.yaml
```yaml
# SPDX-License-Identifier: GPL-2.0-only OR BSD-2-Clause
%YAML 1.2
---
$id: http://devicetree.org/schemas/regulator/sprd,sc2721-regulator.yaml#
$schema: http://devicetree.org/meta-schemas/core.yaml#

title: Unisoc SC2721 core, storage and connectivity voltage regulators

maintainers:
  - FPLinux <fplinux@users.noreply.github.com>

description: |
  The SC2721 eMMC core, SD core and I/O regulators have separate enable controls and
  256 voltage selectors from 1.2 V to 3.75 V in 10 mV steps.
  The shared core regulator reports its inherited voltage and remains on.
  WIFIPA has 256 voltage selectors from 1.2 V to 3.75 V in 10 mV steps.
  CON has 81 voltage selectors from 1.1 V to 1.6 V in 6.25 mV steps.

properties:
  compatible:
    const: sprd,sc2721-regulator

  reg:
    minItems: 1
    maxItems: 6

  regulators:
    type: object
    additionalProperties: false

    properties:
      "#address-cells":
        const: 1

      "#size-cells":
        const: 0

      dcdc@1:
        type: object
        $ref: regulator.yaml#
        unevaluatedProperties: false
        properties:
          reg:
            const: 1
          regulator-name:
            const: vddcore
          regulator-always-on: true
          regulator-min-microvolt: false
          regulator-max-microvolt: false
        required:
          - reg
          - regulator-always-on

      ldo@10:
        type: object
        $ref: regulator.yaml#
        unevaluatedProperties: false
        properties:
          reg:
            const: 10
          regulator-name:
            const: vddemmccore
        required:
          - reg

      ldo@11:
        type: object
        $ref: regulator.yaml#
        unevaluatedProperties: false
        properties:
          reg:
            const: 11
          regulator-name:
            const: vddsdcore
        required:
          - reg

      ldo@12:
        type: object
        $ref: regulator.yaml#
        unevaluatedProperties: false
        properties:
          reg:
            const: 12
          regulator-name:
            const: vddsdio
        required:
          - reg

      ldo@14:
        type: object
        $ref: regulator.yaml#
        unevaluatedProperties: false
        properties:
          reg:
            const: 14
          regulator-name:
            const: vddwifipa
        required:
          - reg

      ldo@18:
        type: object
        $ref: regulator.yaml#
        unevaluatedProperties: false
        properties:
          reg:
            const: 18
          regulator-name:
            const: vddcon
        required:
          - reg

    required:
      - "#address-cells"
      - "#size-cells"
      - ldo@11
      - ldo@12

required:
  - compatible
  - regulators

additionalProperties: false
...
```
