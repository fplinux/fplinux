## buildroot-external/Config.in
```kconfig
menu "FPLinux"

source "$BR2_EXTERNAL_FPLINUX_PATH/package/fplinux-console/Config.in"
source "$BR2_EXTERNAL_FPLINUX_PATH/package/fplinux-input/Config.in"
source "$BR2_EXTERNAL_FPLINUX_PATH/package/fplinux-cpuclock/Config.in"
source "$BR2_EXTERNAL_FPLINUX_PATH/package/fplinux-tyrquake/Config.in"

endmenu
```

## buildroot-external/package/fplinux-console/Config.in
```kconfig
config BR2_PACKAGE_FPLINUX_CONSOLE
	bool "fplinux-console"
	help
	  Build the reusable FPLinux local terminal. The target
	  provides a Linux framebuffer console and an evdev keypad
	  with normalized Linux key codes; this package provides the
	  PTY shell and multi-tap input layer.
```

## buildroot-external/package/fplinux-cpuclock/Config.in
```kconfig
config BR2_PACKAGE_FPLINUX_CPUCLOCK
	bool "fplinux-cpuclock"
	help
	  Measure the CPU clock on the phone by timing a chain of
	  dependent integer additions, which retire at one per cycle
	  on this core. It reads no register and trusts neither the
	  device tree nor the vendor firmware, so it can be used to
	  check a clock frequency that was only ever asserted.
```

## buildroot-external/package/fplinux-input/Config.in
```kconfig
config BR2_PACKAGE_FPLINUX_INPUT
	bool "fplinux-input"
	help
	  Build the FPLinux host input bridge. It reads key events from
	  a serial channel and injects them through uinput, so a
	  keyboard attached to the build host appears on the phone as an
	  ordinary Linux input device.
```

## buildroot-external/package/fplinux-tyrquake/Config.in
```kconfig
config BR2_PACKAGE_FPLINUX_TYRQUAKE
	bool "fplinux-tyrquake"
	depends on BR2_USE_MMU
	help
	  Build TyrQuake 0.71 with native FPLinux fbdev and
	  evdev backends. The software renderer derives its mode
	  from the RGB565 framebuffer geometry, rotates portrait
	  displays into landscape and scales only when the panel is
	  smaller than TyrQuake's minimum render size. The explicit
	  input mode selects the phone or host source; evdev identity
	  and capabilities only validate that source. Sound, CD audio
	  and networking are disabled.

	  The launcher uses a fixed 32 MiB heap and one input
	  mode: the phone keypad or the forwarded host keyboard.
	  Game data is not included. A user-supplied pak0.pak is
	  read from /mnt/card at run time.
```

## platforms/sc9820e/linux/config/defconfig
```kconfig
CONFIG_LOCALVERSION="-fplinux"
# CONFIG_LOCALVERSION_AUTO is not set
CONFIG_DEFAULT_HOSTNAME="fplinux"
CONFIG_CC_OPTIMIZE_FOR_SIZE=y
CONFIG_COMPAT_32BIT_TIME=y
CONFIG_ARCH_MULTIPLATFORM=y
CONFIG_ARCH_MULTI_V7=y
CONFIG_ARCH_SC9820E=y
# CONFIG_ARCH_VIRT is not set
CONFIG_ARM_VIRT_EXT=y
CONFIG_MMU=y
CONFIG_ARM_PATCH_PHYS_VIRT=y
CONFIG_AUTO_ZRELADDR=y
CONFIG_VMSPLIT_3G=y
# CONFIG_ARM_LPAE is not set
CONFIG_SMP=y
CONFIG_NR_CPUS=2
CONFIG_HOTPLUG_CPU=y
CONFIG_AEABI=y
CONFIG_KUSER_HELPERS=y
CONFIG_VFP=y
CONFIG_VFPv3=y
CONFIG_NEON=y
CONFIG_KERNEL_GZIP=y
CONFIG_BINFMT_ELF=y
CONFIG_BINFMT_SCRIPT=y
CONFIG_BLK_DEV_INITRD=y
CONFIG_INITRAMFS_SOURCE=""
CONFIG_RD_GZIP=y
CONFIG_RD_XZ=y
CONFIG_BLOCK=y
CONFIG_BLK_DEV=y
CONFIG_SWAP=y
CONFIG_ZRAM=y
CONFIG_PRINTK=y
CONFIG_PRINTK_TIME=y
CONFIG_KALLSYMS=y
CONFIG_POSIX_TIMERS=y
CONFIG_HIGH_RES_TIMERS=y
CONFIG_HZ_PERIODIC=y
CONFIG_HZ_100=y
CONFIG_FUTEX=y
CONFIG_MULTIUSER=y
CONFIG_SYSCTL=y
CONFIG_EPOLL=y
CONFIG_EVENTFD=y
CONFIG_SIGNALFD=y
CONFIG_TIMERFD=y
CONFIG_TTY=y
CONFIG_UNIX98_PTYS=y
CONFIG_DEVTMPFS=y
CONFIG_DEVTMPFS_MOUNT=y
CONFIG_PROC_FS=y
CONFIG_PROC_SYSCTL=y
CONFIG_SYSFS=y
CONFIG_DEBUG_FS=y
CONFIG_TMPFS=y
CONFIG_CONFIGFS_FS=y
CONFIG_NET=y
CONFIG_PACKET=y
CONFIG_INET=y
CONFIG_UNIX=y
# CONFIG_IPV6 is not set
CONFIG_NETDEVICES=y
CONFIG_INPUT=y
CONFIG_INPUT_EVDEV=y
CONFIG_INPUT_KEYBOARD=y
CONFIG_INPUT_MATRIXKMAP=y
CONFIG_INPUT_MISC=y
CONFIG_INPUT_SC27XX_VIBRA=y
CONFIG_INPUT_UINPUT=y
CONFIG_MFD_SYSCON=y
CONFIG_COMMON_CLK=y
CONFIG_SC9820E_CPU_CLOCK=y
CONFIG_SC9820E_PERIPHERAL_GATES=y
CONFIG_DMADEVICES=y
CONFIG_SPRD_DMA=y
CONFIG_SC9820E_HS_SPI_CLOCK=y
CONFIG_HWSPINLOCK=y
CONFIG_HWSPINLOCK_SPRD=y
CONFIG_SPI=y
CONFIG_SPI_MASTER=y
CONFIG_SPI_SPRD_ADI=y
CONFIG_SPI_SPRD=y
CONFIG_MFD_SC27XX_PMIC=y
CONFIG_BACKLIGHT_CLASS_DEVICE=y
CONFIG_BACKLIGHT_SC2721=y
CONFIG_KEYBOARD_SC9820E=y
CONFIG_KEYBOARD_GPIO=y
CONFIG_VT=y
# CONFIG_SERIAL_SPRD is not set
# CONFIG_PM is not set
CONFIG_CPU_FREQ=y
CONFIG_CPU_FREQ_DEFAULT_GOV_PERFORMANCE=y
CONFIG_CPU_FREQ_GOV_USERSPACE=y
# CONFIG_CPUFREQ_DT is not set
# CONFIG_CPU_IDLE is not set
# CONFIG_SUSPEND is not set
CONFIG_REGULATOR=y
CONFIG_REGULATOR_SC2721=y
CONFIG_GPIO_PMIC_EIC_SPRD=y
# CONFIG_POWER_SUPPLY is not set
CONFIG_POWER_RESET=y
CONFIG_POWER_RESET_SC2721=y
CONFIG_IIO=y
CONFIG_SC27XX_ADC=y
CONFIG_THERMAL=y
CONFIG_THERMAL_OF=y
CONFIG_GENERIC_ADC_THERMAL=y
CONFIG_NEW_LEDS=y
CONFIG_LEDS_CLASS=y
CONFIG_LEDS_SC2721_KPLED=y
CONFIG_LEDS_TRIGGERS=y
CONFIG_LEDS_TRIGGER_INPUT_EVENTS=y
# CONFIG_WATCHDOG is not set
CONFIG_MMC=y
CONFIG_MMC_BLOCK=y
CONFIG_MMC_SDHCI=y
CONFIG_MMC_SDHCI_PLTFM=y
CONFIG_MMC_SDHCI_SPRD=y
CONFIG_SC9820E_SDIO_CLOCK=y
CONFIG_MSDOS_PARTITION=y
CONFIG_VFAT_FS=y
CONFIG_NLS_CODEPAGE_437=y
CONFIG_NLS_ISO8859_1=y
CONFIG_EXT4_FS=y
# CONFIG_MTD is not set
# CONFIG_SCSI is not set
# CONFIG_ATA is not set
# CONFIG_PCI is not set
# CONFIG_MEDIA_SUPPORT is not set
# CONFIG_PINCTRL is not set
CONFIG_GPIOLIB=y
CONFIG_GPIOLIB_IRQCHIP=y
CONFIG_GPIO_SPRD=y
CONFIG_GPIO_CDEV=y
# CONFIG_MODULES is not set
# CONFIG_USB is not set
CONFIG_USB_SUPPORT=y
CONFIG_USB_GADGET=y
CONFIG_USB_MUSB_HDRC=y
CONFIG_USB_MUSB_GADGET=y
CONFIG_MUSB_PIO_ONLY=y
CONFIG_USB_CONFIGFS=y
CONFIG_USB_CONFIGFS_SERIAL=y
CONFIG_USB_CONFIGFS_NCM=y
CONFIG_USB_CONFIGFS_RNDIS=y
# CONFIG_DEBUG_LL is not set
CONFIG_RTC_CLASS=y
# CONFIG_RTC_HCTOSYS is not set
# CONFIG_RTC_SYSTOHC is not set
CONFIG_RTC_DRV_SC27XX=y
CONFIG_NVMEM=y
CONFIG_NVMEM_SC27XX_EFUSE=y
```

## platforms/sc9820e/linux/overlay/Documentation/devicetree/bindings/clock/fplinux,sc9820e-cpu-clock.yaml
```yaml
# SPDX-License-Identifier: (GPL-2.0-only OR BSD-2-Clause)
%YAML 1.2
---
$id: http://devicetree.org/schemas/clock/fplinux,sc9820e-cpu-clock.yaml#
$schema: http://devicetree.org/meta-schemas/core.yaml#

title: SC9820E inherited CPU and TWPLL clocks

maintainers:
  - FPLinux <fplinux@users.noreply.github.com>

description: |
  Reports the inherited MCU clock using its parent selection, divider and PLL
  configuration. Clock queries do not change hardware. When both CPUs use this
  clock and CPU frequency support is enabled, its frequency interface switches
  between the inherited MPLL and lower TWPLL/2 parent. PLL configuration, voltage
  programming, dividers and other selector fields remain unchanged.
  The second output reports the inherited TWPLL without changing its controls.

properties:
  compatible:
    const: fplinux,sc9820e-cpu-clock

  reg:
    items:
      - description: MPLL control registers
      - description: TWPLL control registers

  reg-names:
    items:
      - const: mpll
      - const: twpll

  clocks:
    maxItems: 1

  clock-names:
    const: source

  "#clock-cells":
    const: 1
    description: |
      Clock 0 is the CPU clock and clock 1 is the read-only TWPLL output.

  fplinux,ap-ahb-syscon:
    $ref: /schemas/types.yaml#/definitions/phandle
    description: Shared AP-AHB register map containing the MCU mux and divider.

required:
  - compatible
  - reg
  - reg-names
  - clocks
  - clock-names
  - "#clock-cells"
  - fplinux,ap-ahb-syscon

additionalProperties: false

examples:
  - |
    clock-controller@403f0000 {
        compatible = "fplinux,sc9820e-cpu-clock";
        reg = <0x403f0000 8>, <0x403c000c 8>;
        reg-names = "mpll", "twpll";
        #clock-cells = <1>;
        clock-names = "source";
        clocks = <&ext26m>;
        fplinux,ap-ahb-syscon = <&ap_ahb>;
    };
```

## platforms/sc9820e/linux/overlay/Documentation/devicetree/bindings/clock/fplinux,sc9820e-gpu-clock.yaml
```yaml
# SPDX-License-Identifier: (GPL-2.0-only OR BSD-2-Clause)
%YAML 1.2
---
$id: http://devicetree.org/schemas/clock/fplinux,sc9820e-gpu-clock.yaml#
$schema: http://devicetree.org/meta-schemas/core.yaml#

title: SC9820E GPU clock and access preparation

maintainers:
  - FPLinux <fplinux@users.noreply.github.com>

description: |
  The provider prepares GPU_TOP, the AON module gate and GPU control registers
  for the TWPLL/6, TWPLL/4 or TWPLL/3 input without changing PLL or shared
  core-rail settings. An assigned clock rate selects one input before prepare;
  the default is TWPLL/6. Rate changes are blocked while prepared.
  It accepts the inherited undivided clock and checks the shared core rail
  against the target's expected voltage before preparing GPU resources.
  The clock rate is zero while unprepared because the gated mux is inaccessible.
  Unprepare restores the owned fields and preserves an inherited enabled gate.

properties:
  compatible:
    const: fplinux,sc9820e-gpu-clock

  reg:
    items:
      - description: GPU clock control word
      - description: GPU QoS control word
      - description: GPU reset control word, observed without writes

  reg-names:
    items:
      - const: clock
      - const: qos
      - const: reset

  "#clock-cells":
    const: 0

  clocks:
    description: Undivided TWPLL source.
    maxItems: 1

  clock-names:
    const: source

  assigned-clocks:
    maxItems: 1

  assigned-clock-rates:
    items:
      - enum: [256000000, 384000000, 512000000]
    description: Nominal input rate selected before GPU resources are prepared.

  core-supply:
    description: Shared always-on core rail with read-only voltage observation.

  fplinux,expected-core-microvolt:
    minimum: 1
    description: |
      Required inherited core voltage for the target's selected GPU input.
      This is an observation precondition and never requests a voltage change.

  fplinux,aon-syscon:
    $ref: /schemas/types.yaml#/definitions/phandle
    description: Shared AON register map with atomic set and clear aliases.

  fplinux,pmu-syscon:
    $ref: /schemas/types.yaml#/definitions/phandle
    description: Shared PMU register map containing GPU_TOP configuration.

required:
  - compatible
  - reg
  - reg-names
  - "#clock-cells"
  - clocks
  - clock-names
  - core-supply
  - fplinux,expected-core-microvolt
  - fplinux,aon-syscon
  - fplinux,pmu-syscon

additionalProperties: false
```

## platforms/sc9820e/linux/overlay/Documentation/devicetree/bindings/clock/fplinux,sc9820e-hs-spi-clock.yaml
```yaml
# SPDX-License-Identifier: (GPL-2.0-only OR BSD-2-Clause)
%YAML 1.2
---
$id: http://devicetree.org/schemas/clock/fplinux,sc9820e-hs-spi-clock.yaml#
$schema: http://devicetree.org/meta-schemas/core.yaml#

title: SC9820E high-speed SPI source mux and divider

maintainers:
  - FPLinux <fplinux@users.noreply.github.com>

properties:
  compatible:
    const: fplinux,sc9820e-hs-spi-clock

  reg:
    maxItems: 1

  "#clock-cells":
    const: 0

  clocks:
    items:
      - description: 26 MHz oscillator
      - description: TWPLL divided by twelve
      - description: TWPLL divided by ten
      - description: TWPLL divided by eight

  clock-names:
    items:
      - const: ext26m
      - const: twpll128m
      - const: twpll153m6
      - const: twpll192m

required:
  - compatible
  - reg
  - "#clock-cells"
  - clocks
  - clock-names

additionalProperties: false
```

## platforms/sc9820e/linux/overlay/Documentation/devicetree/bindings/clock/fplinux,sc9820e-i2c2-clock.yaml
```yaml
# SPDX-License-Identifier: (GPL-2.0-only OR BSD-2-Clause)
%YAML 1.2
---
$id: http://devicetree.org/schemas/clock/fplinux,sc9820e-i2c2-clock.yaml#
$schema: http://devicetree.org/meta-schemas/core.yaml#

title: SC9820E I2C2 oscillator clock observation and module gate

maintainers:
  - FPLinux <fplinux@users.noreply.github.com>

description: |
  Clock index 0 reports the inherited oscillator input with no divider.
  It reports zero for other parent or divider settings and never changes them.
  Clock index 1 controls the I2C2 AP-APB module gate.

properties:
  compatible:
    const: fplinux,sc9820e-i2c2-clock

  reg:
    maxItems: 1

  "#clock-cells":
    const: 1

  clocks:
    maxItems: 1

  clock-names:
    const: source

  fplinux,ap-apb-syscon:
    $ref: /schemas/types.yaml#/definitions/phandle
    description: Shared AP-APB register map with atomic set and clear aliases.

required:
  - compatible
  - reg
  - "#clock-cells"
  - clocks
  - clock-names
  - fplinux,ap-apb-syscon

additionalProperties: false
```

## platforms/sc9820e/linux/overlay/Documentation/devicetree/bindings/clock/fplinux,sc9820e-peripheral-gates.yaml
```yaml
# SPDX-License-Identifier: (GPL-2.0-only OR BSD-2-Clause)
%YAML 1.2
---
$id: http://devicetree.org/schemas/clock/fplinux,sc9820e-peripheral-gates.yaml#
$schema: http://devicetree.org/meta-schemas/core.yaml#

title: SC9820E peripheral clock gates

maintainers:
  - FPLinux <fplinux@users.noreply.github.com>

allOf:
  - if:
      properties:
        compatible:
          const: fplinux,sc9820e-ap-dma-gate
    then:
      properties:
        fplinux,aon-syscon: false
      required:
        - fplinux,ap-ahb-syscon
    else:
      properties:
        fplinux,ap-ahb-syscon: false
      required:
        - fplinux,aon-syscon

properties:
  compatible:
    enum:
      - fplinux,sc9820e-aon-gate
      - fplinux,sc9820e-hs-spi-gate
      - fplinux,sc9820e-gpio-gate
      - fplinux,sc9820e-efuse-gate
      - fplinux,sc9820e-mailbox-gate
      - fplinux,sc9820e-ap-dma-gate

  "#clock-cells":
    const: 0

  fplinux,aon-syscon:
    $ref: /schemas/types.yaml#/definitions/phandle
    description: Shared AON register map containing the set and clear aliases.

  fplinux,ap-ahb-syscon:
    $ref: /schemas/types.yaml#/definitions/phandle
    description: Shared AP-AHB register map containing the set and clear aliases.

required:
  - compatible
  - "#clock-cells"

additionalProperties: false
```

## platforms/sc9820e/linux/overlay/Documentation/devicetree/bindings/clock/fplinux,sc9820e-sdio-clock.yaml
```yaml
# SPDX-License-Identifier: (GPL-2.0-only OR BSD-2-Clause)
%YAML 1.2
---
$id: http://devicetree.org/schemas/clock/fplinux,sc9820e-sdio-clock.yaml#
$schema: http://devicetree.org/meta-schemas/core.yaml#

title: SC9820E storage oscillator muxes and AP-AHB gates

maintainers:
  - FPLinux <fplinux@users.noreply.github.com>

description: |
  Each provider controls one storage mux register and its AP-AHB gate. Output 0
  is the mux clock and output 1 is the AHB gate. The supported mux inputs
  are the 1 MHz oscillator at selector 0 and the 26 MHz oscillator at
  selector 1.

properties:
  compatible:
    enum:
      - fplinux,sc9820e-sdio-clock
      - fplinux,sc9820e-emmc-clock

  reg:
    maxItems: 1

  "#clock-cells":
    const: 1

  clocks:
    items:
      - description: 1 MHz oscillator, mux selector 0
      - description: 26 MHz oscillator, mux selector 1

  clock-names:
    items:
      - const: ext1m
      - const: ext26m

  fplinux,ap-ahb-syscon:
    $ref: /schemas/types.yaml#/definitions/phandle
    description: AP-AHB register map with atomic set and clear aliases

required:
  - compatible
  - reg
  - "#clock-cells"
  - clocks
  - clock-names
  - fplinux,ap-ahb-syscon

additionalProperties: false
```
