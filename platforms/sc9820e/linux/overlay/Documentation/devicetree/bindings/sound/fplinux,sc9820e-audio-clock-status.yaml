## platforms/sc9820e/linux/overlay/Documentation/devicetree/bindings/sound/fplinux,sc9820e-audio-clock-status.yaml
```yaml
# SPDX-License-Identifier: (GPL-2.0-only OR BSD-2-Clause)
%YAML 1.2
---
$id: http://devicetree.org/schemas/sound/fplinux,sc9820e-audio-clock-status.yaml#
$schema: http://devicetree.org/meta-schemas/core.yaml#

title: SC9820E audio clock-stability status

maintainers:
  - FPLinux contributors <313246064+fplinux-dev@users.noreply.github.com>

description: |
  Read-only clock-stability status word used by microphone capture.
  The consumer maps this resource through its sprd,clock-stable phandle.

properties:
  compatible:
    const: fplinux,sc9820e-audio-clock-status

  reg:
    maxItems: 1
    description: Register window containing one 32-bit status word.

required:
  - compatible
  - reg

additionalProperties: false
```

## platforms/sc9820e/linux/overlay/Documentation/devicetree/bindings/sound/sprd,sharkl2-audio-codec.yaml
```yaml
# SPDX-License-Identifier: (GPL-2.0-only OR BSD-2-Clause)
%YAML 1.2
---
$id: http://devicetree.org/schemas/sound/sprd,sharkl2-audio-codec.yaml#
$schema: http://devicetree.org/meta-schemas/core.yaml#

title: Spreadtrum SharkL2 digital audio codec registers

maintainers:
  - FPLinux contributors <313246064+fplinux-dev@users.noreply.github.com>

description: |
  The SC9820E microphone capture route maps this digital codec bank through
  its sprd,digital-codec phandle and controls it together with the VBC bank.

properties:
  compatible:
    const: sprd,sharkl2-audio-codec

  reg:
    maxItems: 1
    description: Digital audio codec register window, at least 0x2000 bytes.

required:
  - compatible
  - reg

additionalProperties: false
```

## platforms/sc9820e/linux/overlay/Documentation/devicetree/bindings/sound/sprd,vbc-r1p0v3.yaml
```yaml
# SPDX-License-Identifier: (GPL-2.0-only OR BSD-2-Clause)
%YAML 1.2
---
$id: http://devicetree.org/schemas/sound/sprd,vbc-r1p0v3.yaml#
$schema: http://devicetree.org/meta-schemas/core.yaml#

title: Spreadtrum VBC r1p0v3 register bank

maintainers:
  - FPLinux contributors <313246064+fplinux-dev@users.noreply.github.com>

description: |
  VBC control registers and capture FIFO. The SC9820E microphone capture
  consumer maps this bank through its sprd,vbc phandle.

properties:
  compatible:
    const: sprd,vbc-r1p0v3

  reg:
    maxItems: 1
    description: VBC register and FIFO window, at least 0x10000 bytes.

required:
  - compatible
  - reg

additionalProperties: false
```

## platforms/sc9820e/linux/overlay/Documentation/devicetree/bindings/spi/sprd,spi-r4p0.yaml
```yaml
# SPDX-License-Identifier: (GPL-2.0-only OR BSD-2-Clause)
%YAML 1.2
---
$id: http://devicetree.org/schemas/spi/sprd,spi-r4p0.yaml#
$schema: http://devicetree.org/meta-schemas/core.yaml#

title: Spreadtrum r4p0 SPI controller

maintainers:
  - FPLinux <fplinux@users.noreply.github.com>

allOf:
  - $ref: spi-controller.yaml#

properties:
  compatible:
    const: sprd,spi-r4p0

  reg:
    maxItems: 1

  interrupts:
    maxItems: 1

  clocks:
    items:
      - description: SPI module enable clock
      - description: SPI serial clock
      - description: Oscillator source clock

  clock-names:
    items:
      - const: enable
      - const: spi
      - const: source

  sprd,spi-mode:
    $ref: /schemas/types.yaml#/definitions/uint32
    const: 3
    description: Hardware transfer mode.

  sprd,spi-interval:
    $ref: /schemas/types.yaml#/definitions/uint32
    const: 1
    description: Hardware inter-word interval encoding.

  dmas:
    maxItems: 1

  dma-names:
    const: tx_chn

required:
  - compatible
  - reg
  - interrupts
  - clocks
  - clock-names
  - sprd,spi-mode
  - sprd,spi-interval

dependencies:
  dmas: [dma-names]
  dma-names: [dmas]

unevaluatedProperties: false
```

## platforms/sc9820e/linux/overlay/arch/arm/mach-sc9820e/Kconfig
```kconfig
# SPDX-License-Identifier: GPL-2.0-only
menuconfig ARCH_SC9820E
	bool "Unisoc SC9820E"
	depends on ARCH_MULTI_V7
	select ARM_AMBA
	select ARM_GIC
	select ARM_GIC_V3
	select ARM_PSCI
	select HAVE_ARM_ARCH_TIMER
	help
	  Enable the native Device Tree machine for SC9820E ARM systems.
	  The target supplies peripheral resources and board wiring in Device Tree.
	  Interrupts, PSCI and the architectural timer use generic ARM drivers.
	  Peripherals marked inherited require state from the RAM boot path.
```

## platforms/ums9117/buildroot/toolchain-external.defconfig
```kconfig
BR2_arm=y
BR2_cortex_a7=y
BR2_ARM_ENABLE_NEON=y
BR2_ARM_ENABLE_VFP=y
BR2_ARM_FPU_VFPV4=y
BR2_ARM_EABIHF=y
BR2_TOOLCHAIN_EXTERNAL=y
BR2_TOOLCHAIN_EXTERNAL_CUSTOM=y
BR2_TOOLCHAIN_EXTERNAL_PREINSTALLED=y
BR2_TOOLCHAIN_EXTERNAL_CUSTOM_PREFIX="arm-buildroot-linux-musleabihf"
BR2_TOOLCHAIN_EXTERNAL_GCC_14=y
BR2_TOOLCHAIN_EXTERNAL_HEADERS_6_18=y
BR2_TOOLCHAIN_EXTERNAL_CUSTOM_MUSL=y
BR2_TOOLCHAIN_EXTERNAL_WCHAR=y
BR2_TOOLCHAIN_EXTERNAL_HAS_SSP=y
BR2_TOOLCHAIN_EXTERNAL_HAS_THREADS=y
BR2_TOOLCHAIN_EXTERNAL_HAS_THREADS_NPTL=y
```

## platforms/ums9117/buildroot/toolchain.defconfig
```kconfig
BR2_arm=y
BR2_cortex_a7=y
BR2_ARM_ENABLE_NEON=y
BR2_ARM_ENABLE_VFP=y
BR2_ARM_FPU_VFPV4=y
BR2_ARM_EABIHF=y
BR2_CCACHE=y
BR2_CCACHE_DIR="/cache/ccache"
BR2_TOOLCHAIN_BUILDROOT_MUSL=y
BR2_KERNEL_HEADERS_VERSION=y
BR2_DEFAULT_KERNEL_VERSION="6.18.40"
BR2_PACKAGE_HOST_LINUX_HEADERS_CUSTOM_6_18=y
BR2_GLOBAL_PATCH_DIR="$(BR2_EXTERNAL_FPLINUX_PATH)/patches"
BR2_DOWNLOAD_FORCE_CHECK_HASHES=y
BR2_REPRODUCIBLE=y
BR2_INIT_NONE=y
# BR2_TARGET_GENERIC_GETTY is not set
```

## platforms/ums9117/kernel/Kconfig
```kconfig
# SPDX-License-Identifier: GPL-2.0-only
menuconfig ARCH_UMS9117
	bool "Unisoc UMS9117/T117"
	depends on ARCH_MULTI_V7
	select ARM_GIC
	select CLKSRC_MMIO
	select SPRD_TIMER
	help
	  Minimal Device Tree support for RAM-booted UMS9117/T117 systems:
	  a single Cortex-A7 with a GIC-400 behind ARCH_MULTI_V7. The port
	  lets most peripheral blocks adopt state left by the BootROM/FDL
	  download path. The Nokia TA-1618 USB peripheral profile is a narrow
	  exception: it explicitly reinitializes its controller, PHY and USB
	  3.3 V supply. The 1 ms AP system counter provides the clocksource,
	  the 32 kHz AON timer the clockevent, and the ARM architected timer
	  stays disabled because it reads zero on this SoC.
```

## platforms/ums9117/kernel/defconfig
```kconfig
CONFIG_LOCALVERSION="-fplinux"
# CONFIG_LOCALVERSION_AUTO is not set
CONFIG_KERNEL_XZ=y
CONFIG_DEFAULT_HOSTNAME="fplinux"
CONFIG_SYSVIPC=y
CONFIG_HIGH_RES_TIMERS=y
CONFIG_BLK_DEV_INITRD=y
CONFIG_SWAP=y
CONFIG_ZRAM=y
CONFIG_CC_OPTIMIZE_FOR_SIZE=y
CONFIG_LD_DEAD_CODE_DATA_ELIMINATION=y
CONFIG_EXPERT=y
# CONFIG_FHANDLE is not set
CONFIG_POSIX_TIMERS=y
# CONFIG_AIO is not set
# CONFIG_IO_URING is not set
# CONFIG_ADVISE_SYSCALLS is not set
# CONFIG_MEMBARRIER is not set
# CONFIG_RSEQ is not set
# CONFIG_CACHESTAT_SYSCALL is not set
CONFIG_ARCH_UMS9117=y
CONFIG_THUMB2_KERNEL=y
# CONFIG_ATAGS is not set
CONFIG_VFP=y
CONFIG_SUSPEND=y
CONFIG_KPROBES=y
# CONFIG_SECCOMP is not set
# CONFIG_STACKPROTECTOR is not set
CONFIG_MODULES=y
CONFIG_MODULE_UNLOAD=y
CONFIG_PARTITION_ADVANCED=y
# CONFIG_COREDUMP is not set
CONFIG_SLUB_TINY=y
# CONFIG_COMPAT_BRK is not set
# CONFIG_VM_EVENT_COUNTERS is not set
CONFIG_CMA=y
CONFIG_NET=y
CONFIG_PACKET=y
CONFIG_INET=y
CONFIG_UNIX=y
CONFIG_BT=y
CONFIG_BT_BREDR=y
CONFIG_BT_RFCOMM=y
CONFIG_BT_BNEP=y
CONFIG_BT_UMS9117_CM4=y
# CONFIG_IPV6 is not set
CONFIG_DEVTMPFS=y
CONFIG_DEVTMPFS_MOUNT=y
# CONFIG_STANDALONE is not set
# CONFIG_PREVENT_FIRMWARE_BUILD is not set
CONFIG_FW_LOADER=y
# CONFIG_ALLOW_DEV_COREDUMP is not set
CONFIG_NETDEVICES=y
CONFIG_INPUT_EVDEV=y
CONFIG_KEYBOARD_UMS9117=y
# CONFIG_INPUT_MOUSE is not set
CONFIG_INPUT_MISC=y
CONFIG_INPUT_UINPUT=y
# CONFIG_HW_RANDOM is not set
# CONFIG_DEVMEM is not set
# CONFIG_DEVPORT is not set
# CONFIG_GPIO_CDEV is not set
CONFIG_POWER_SUPPLY=y
# CONFIG_HWMON is not set
CONFIG_THERMAL=y
# CONFIG_THERMAL_OF is not set
CONFIG_REGULATOR=y
CONFIG_MEDIA_SUPPORT=y
CONFIG_MEDIA_SUPPORT_FILTER=y
# CONFIG_MEDIA_SUBDRV_AUTOSELECT is not set
CONFIG_MEDIA_PLATFORM_SUPPORT=y
CONFIG_V4L_MEM2MEM_DRIVERS=y
CONFIG_VIDEO_UMS9117_ROTA=y
CONFIG_VIDEO_UMS9117_JPEG=y
CONFIG_FB=y
CONFIG_FRAMEBUFFER_CONSOLE=y
CONFIG_FRAMEBUFFER_CONSOLE_DETECT_PRIMARY=y
# CONFIG_SOUND is not set
# CONFIG_HID is not set
CONFIG_USB_MUSB_HDRC=y
CONFIG_USB_MUSB_UMS9117=y
CONFIG_MUSB_PIO_ONLY=y
CONFIG_USB_GADGET=y
CONFIG_USB_CONFIGFS=y
CONFIG_USB_CONFIGFS_SERIAL=y
CONFIG_USB_CONFIGFS_NCM=y
CONFIG_NEW_LEDS=y
CONFIG_LEDS_CLASS=y
CONFIG_RTC_CLASS=y
# CONFIG_RTC_HCTOSYS is not set
# CONFIG_RTC_SYSTOHC is not set
# CONFIG_RTC_NVMEM is not set
CONFIG_DMADEVICES=y
CONFIG_UMS9117_DMA=y
CONFIG_DMATEST=y
CONFIG_DMA_CMA=y
CONFIG_CMA_SIZE_MBYTES=0
# CONFIG_VIRTIO_MENU is not set
# CONFIG_VHOST_MENU is not set
CONFIG_SPRD_UMS9117_INHERITED_CLK=y
CONFIG_IIO=y
# CONFIG_DNOTIFY is not set
# CONFIG_INOTIFY_USER is not set
CONFIG_VFAT_FS=y
CONFIG_EXT4_FS=y
CONFIG_TMPFS=y
# CONFIG_MISC_FILESYSTEMS is not set
CONFIG_NLS_CODEPAGE_437=y
CONFIG_NLS_ISO8859_1=y
# CONFIG_CRC_OPTIMIZATIONS is not set
CONFIG_FONTS=y
CONFIG_PRINTK_TIME=y
# CONFIG_SYMBOLIC_ERRNAME is not set
# CONFIG_DEBUG_MISC is not set
# CONFIG_SECTION_MISMATCH_WARN_ONLY is not set
CONFIG_DEBUG_FS=y
CONFIG_IRQSOFF_TRACER=y
# CONFIG_RUNTIME_TESTING_MENU is not set
```

## platforms/ums9117/linux/defconfig
```kconfig
CONFIG_LOCALVERSION="-fplinux"
# CONFIG_LOCALVERSION_AUTO is not set
CONFIG_KERNEL_XZ=y
CONFIG_DEFAULT_HOSTNAME="fplinux"
CONFIG_SYSVIPC=y
CONFIG_HIGH_RES_TIMERS=y
CONFIG_NO_HZ_IDLE=y
CONFIG_BLK_DEV_INITRD=y
CONFIG_SWAP=y
CONFIG_ZRAM=y
CONFIG_CC_OPTIMIZE_FOR_SIZE=y
CONFIG_LD_DEAD_CODE_DATA_ELIMINATION=y
CONFIG_EXPERT=y
# CONFIG_FHANDLE is not set
CONFIG_POSIX_TIMERS=y
# CONFIG_AIO is not set
# CONFIG_IO_URING is not set
# CONFIG_ADVISE_SYSCALLS is not set
# CONFIG_MEMBARRIER is not set
# CONFIG_RSEQ is not set
# CONFIG_CACHESTAT_SYSCALL is not set
CONFIG_ARCH_UMS9117=y
CONFIG_THUMB2_KERNEL=y
# CONFIG_ATAGS is not set
CONFIG_VFP=y
CONFIG_CPU_FREQ=y
CONFIG_CPU_FREQ_DEFAULT_GOV_PERFORMANCE=y
CONFIG_CPU_FREQ_GOV_USERSPACE=y
CONFIG_CPUFREQ_DT=y
CONFIG_SUSPEND=y
CONFIG_KPROBES=y
# CONFIG_SECCOMP is not set
# CONFIG_STACKPROTECTOR is not set
CONFIG_MODULES=y
CONFIG_MODULE_UNLOAD=y
CONFIG_PARTITION_ADVANCED=y
# CONFIG_COREDUMP is not set
CONFIG_SLUB_TINY=y
# CONFIG_COMPAT_BRK is not set
# CONFIG_VM_EVENT_COUNTERS is not set
CONFIG_CMA=y
CONFIG_NET=y
CONFIG_PACKET=y
CONFIG_INET=y
CONFIG_UNIX=y
CONFIG_BT=y
CONFIG_BT_BREDR=y
CONFIG_BT_RFCOMM=y
CONFIG_BT_BNEP=y
CONFIG_BT_HIDP=y
CONFIG_BT_UMS9117_CM4=y
# CONFIG_IPV6 is not set
CONFIG_DEVTMPFS=y
CONFIG_DEVTMPFS_MOUNT=y
# CONFIG_STANDALONE is not set
# CONFIG_PREVENT_FIRMWARE_BUILD is not set
CONFIG_FW_LOADER=y
CONFIG_MAILBOX=y
CONFIG_BT_HCIUART=y
# CONFIG_ALLOW_DEV_COREDUMP is not set
CONFIG_NETDEVICES=y
CONFIG_INPUT_EVDEV=y
CONFIG_KEYBOARD_UMS9117=y
# CONFIG_INPUT_MOUSE is not set
CONFIG_INPUT_MISC=y
CONFIG_INPUT_UINPUT=y
# CONFIG_HW_RANDOM is not set
# CONFIG_DEVMEM is not set
# CONFIG_DEVPORT is not set
# CONFIG_GPIO_CDEV is not set
CONFIG_POWER_RESET=y
CONFIG_POWER_RESET_SC2720_UMS9117=y
CONFIG_POWER_SUPPLY=y
CONFIG_POWER_SUPPLY_SC2720_CHARGER_UMS9117=y
CONFIG_POWER_SUPPLY_SC2720_FGU_UMS9117=y
# CONFIG_HWMON is not set
CONFIG_THERMAL=y
CONFIG_THERMAL_OF=y
CONFIG_SPRD_THERMAL=y
CONFIG_REGULATOR=y
CONFIG_REGULATOR_SC2731=y
CONFIG_MEDIA_SUPPORT=y
CONFIG_MEDIA_SUPPORT_FILTER=y
# CONFIG_MEDIA_SUBDRV_AUTOSELECT is not set
CONFIG_MEDIA_PLATFORM_SUPPORT=y
CONFIG_MEDIA_RADIO_SUPPORT=y
CONFIG_RADIO_UMS9117_CM4=y
CONFIG_V4L_MEM2MEM_DRIVERS=y
CONFIG_VIDEO_UMS9117_ROTA=y
CONFIG_VIDEO_UMS9117_JPEG=y
CONFIG_FB=y
CONFIG_FRAMEBUFFER_CONSOLE=y
CONFIG_FRAMEBUFFER_CONSOLE_DETECT_PRIMARY=y
# CONFIG_SOUND is not set
CONFIG_HID=y
CONFIG_HID_GENERIC=y
CONFIG_UHID=y
CONFIG_USB_MUSB_HDRC=y
CONFIG_USB_MUSB_UMS9117=y
CONFIG_MUSB_PIO_ONLY=y
CONFIG_USB_GADGET=y
CONFIG_USB_CONFIGFS=y
CONFIG_USB_CONFIGFS_SERIAL=y
CONFIG_USB_CONFIGFS_NCM=y
CONFIG_MMC=y
CONFIG_MMC_SDHCI=y
CONFIG_MMC_SDHCI_PLTFM=y
CONFIG_MMC_SDHCI_UMS9117=y
CONFIG_NEW_LEDS=y
CONFIG_LEDS_CLASS=y
CONFIG_LEDS_SC2720_KPLED_UMS9117=y
CONFIG_LEDS_TRIGGERS=y
CONFIG_LEDS_TRIGGER_INPUT_EVENTS=y
CONFIG_RTC_CLASS=y
# CONFIG_RTC_HCTOSYS is not set
# CONFIG_RTC_SYSTOHC is not set
# CONFIG_RTC_NVMEM is not set
CONFIG_RTC_DRV_SC27XX=y
CONFIG_DMADEVICES=y
CONFIG_SPRD_DMA=y
CONFIG_DMATEST=y
CONFIG_DMA_CMA=y
CONFIG_CMA_SIZE_MBYTES=0
# CONFIG_VIRTIO_MENU is not set
# CONFIG_VHOST_MENU is not set
CONFIG_SPRD_UMS9117_INHERITED_CLK=y
CONFIG_COMMON_CLK=y
CONFIG_SPRD_COMMON_CLK=y
CONFIG_SPRD_UMS9117_CLK=y
CONFIG_COMMON_CLK_SC2720=y
CONFIG_RESET_UMS9117=y
CONFIG_UMS9117_NANDC_RO=y
CONFIG_HWSPINLOCK=y
CONFIG_HWSPINLOCK_SPRD=y
CONFIG_SPI=y
CONFIG_SPI_SPRD_ADI=y
CONFIG_MFD_SC27XX_PMIC=y
CONFIG_NVMEM=y
CONFIG_NVMEM_SC27XX_EFUSE=y
CONFIG_NVMEM_SPRD_EFUSE=y
CONFIG_PINCTRL=y
CONFIG_PINCTRL_SINGLE=y
CONFIG_IIO=y
CONFIG_SC27XX_ADC=y
# CONFIG_DNOTIFY is not set
# CONFIG_INOTIFY_USER is not set
CONFIG_VFAT_FS=y
CONFIG_EXT4_FS=y
CONFIG_TMPFS=y
# CONFIG_MISC_FILESYSTEMS is not set
CONFIG_NLS_CODEPAGE_437=y
CONFIG_NLS_ISO8859_1=y
# CONFIG_CRC_OPTIMIZATIONS is not set
CONFIG_FONTS=y
CONFIG_PRINTK_TIME=y
# CONFIG_SYMBOLIC_ERRNAME is not set
# CONFIG_DEBUG_MISC is not set
# CONFIG_SECTION_MISMATCH_WARN_ONLY is not set
CONFIG_DEBUG_FS=y
CONFIG_IRQSOFF_TRACER=y
# CONFIG_RUNTIME_TESTING_MENU is not set
```

## platforms/ums9117/linux/drivers/media/platform/ums9117/Kconfig
```kconfig
# SPDX-License-Identifier: GPL-2.0-only
config VIDEO_UMS9117_ROTA
	tristate "Unisoc UMS9117 image rotation engine"
	depends on V4L_MEM2MEM_DRIVERS
	depends on VIDEO_DEV
	depends on ARCH_UMS9117 || COMPILE_TEST
	depends on OF
	depends on SPRD_DMA
	select V4L2_MEM2MEM_DEV
	select VIDEOBUF2_DMA_CONTIG
	help
	  V4L2 memory-to-memory support for the UMS9117 ROTA image rotation
	  engine. The engine uses a dedicated request route on the UMS9117 AP
	  DMA controller and has no separate completion interrupt. It supports
	  the hardware's packed RGB, grayscale, and semiplanar YUV formats.

config VIDEO_UMS9117_JPEG
	bool "Unisoc UMS9117 JPEG decoder"
	depends on V4L_MEM2MEM_DRIVERS
	depends on VIDEO_DEV
	depends on ARCH_UMS9117 || COMPILE_TEST
	depends on OF
	select V4L2_MEM2MEM_DEV
	select V4L2_JPEG_HELPER
	select MEDIA_CONTROLLER
	select V4L2_ASYNC
	select VIDEOBUF2_DMA_CONTIG
	select VIDEOBUF2_VMALLOC
	help
	  JPEG decode, encode and scaling through the UMS9117 VSP, and
	  camera capture through the shared DCAM when a camera input route
	  is enabled and a sensor is connected.
	  Select the input route matching the board's DCAM endpoint.

config VIDEO_UMS9117_DCAM_PARALLEL
	bool "UMS9117 parallel camera input"
	depends on VIDEO_UMS9117_JPEG
	select V4L2_FWNODE
	help
	  Capture NV16 frames through an 8-bit parallel camera input.
	  The DCAM endpoint describes the bus width and signal polarities.
	  Enable this in the board fragment when that route is connected.
	  The input route is checked before the capture device is registered.

config VIDEO_UMS9117_DCAM_SERIAL_G0
	bool "UMS9117 serial-G0 camera input"
	depends on VIDEO_UMS9117_JPEG
	help
	  Capture NV16 frames through a one-bit serial-G0 camera input.
	  The DCAM endpoint declares sprd,serial-g0-data-width for this route.
	  Enable this in the board fragment when that route is connected.
	  The input route is checked before the capture device is registered.
```
