## platforms/ums9117/linux/overlay/Documentation/devicetree/bindings/media/i2c/byd,bf20a6.yaml
```yaml
# SPDX-License-Identifier: (GPL-2.0-only OR BSD-2-Clause)
%YAML 1.2
---
$id: http://devicetree.org/schemas/media/i2c/byd,bf20a6.yaml#
$schema: http://devicetree.org/meta-schemas/core.yaml#

title: BF20A6 CMOS image sensor

maintainers:
  - FPLinux contributors <313246064+fplinux-dev@users.noreply.github.com>

allOf:
  - $ref: /schemas/media/video-interface-devices.yaml#

properties:
  compatible:
    const: byd,bf20a6

  reg:
    const: 0x6e

  clocks:
    maxItems: 1

  clock-names:
    const: xclk

  avdd-supply: true
  iovdd-supply: true

  powerdown-gpios:
    maxItems: 1

  front-powerdown-gpios:
    maxItems: 1
    description: Powerdown line held active for the companion camera route.

  pinctrl-names:
    const: default

  pinctrl-0: true

  rotation: true

  port:
    $ref: /schemas/graph.yaml#/$defs/port-base
    additionalProperties: false
    properties:
      endpoint:
        $ref: /schemas/graph.yaml#/$defs/endpoint-base
        unevaluatedProperties: false
        properties:
          sprd,serial-g0-data-width:
            $ref: /schemas/types.yaml#/definitions/uint32
            const: 2
            description: Selects the two-bit UMS9117 serial G0 input configuration.
        required:
          - remote-endpoint
          - sprd,serial-g0-data-width
    required:
      - endpoint

required:
  - compatible
  - reg
  - clocks
  - clock-names
  - avdd-supply
  - iovdd-supply
  - powerdown-gpios
  - front-powerdown-gpios
  - port

additionalProperties: false
```

## platforms/ums9117/linux/overlay/Documentation/devicetree/bindings/media/i2c/galaxycore,gc032a.yaml
```yaml
# SPDX-License-Identifier: (GPL-2.0-only OR BSD-2-Clause)
%YAML 1.2
---
$id: http://devicetree.org/schemas/media/i2c/galaxycore,gc032a.yaml#
$schema: http://devicetree.org/meta-schemas/core.yaml#

title: GalaxyCore GC032A CMOS image sensor

maintainers:
  - FPLinux contributors <313246064+fplinux-dev@users.noreply.github.com>

allOf:
  - $ref: /schemas/media/video-interface-devices.yaml#

properties:
  compatible:
    const: galaxycore,gc032a

  reg:
    const: 0x21

  clocks:
    maxItems: 1

  clock-names:
    const: xclk

  avdd-supply: true
  iovdd-supply: true

  powerdown-gpios:
    maxItems: 1

  front-powerdown-gpios:
    maxItems: 1
    description: Powerdown line held active for the companion camera route.

  pinctrl-names:
    const: default

  pinctrl-0: true

  rotation: true

  port:
    $ref: /schemas/graph.yaml#/$defs/port-base
    additionalProperties: false
    properties:
      endpoint:
        $ref: /schemas/graph.yaml#/$defs/endpoint-base
        unevaluatedProperties: false
        properties:
          sprd,serial-g0-data-width:
            $ref: /schemas/types.yaml#/definitions/uint32
            const: 2
            description: Two data lines on the UMS9117 serial G0 camera input.
        required:
          - remote-endpoint
          - sprd,serial-g0-data-width
    required:
      - endpoint

required:
  - compatible
  - reg
  - clocks
  - clock-names
  - avdd-supply
  - iovdd-supply
  - powerdown-gpios
  - front-powerdown-gpios
  - port

additionalProperties: false
```

## platforms/ums9117/linux/overlay/drivers/media/platform/ums9117/Kconfig
```kconfig
# SPDX-License-Identifier: GPL-2.0-only
config VIDEO_UMS9117_ROTA
	tristate "Unisoc UMS9117 image rotation engine"
	depends on V4L_MEM2MEM_DRIVERS
	depends on VIDEO_DEV
	depends on ARCH_UMS9117 || COMPILE_TEST
	depends on OF
	depends on SPRD_DMA
	select V4L2_MEM2MEM_DEV
	select VIDEOBUF2_DMA_CONTIG
	help
	  V4L2 memory-to-memory support for the UMS9117 ROTA image rotation
	  engine. The engine uses a dedicated request route on the UMS9117 AP
	  DMA controller and has no separate completion interrupt. It supports
	  the hardware's packed RGB, grayscale, and semiplanar YUV formats.

config VIDEO_UMS9117_JPEG
	bool "Unisoc UMS9117 JPEG, scaling and camera engine"
	depends on V4L_MEM2MEM_DRIVERS
	depends on VIDEO_DEV
	depends on ARCH_UMS9117 || COMPILE_TEST
	depends on OF
	select V4L2_MEM2MEM_DEV
	select V4L2_JPEG_HELPER
	select MEDIA_CONTROLLER
	select V4L2_ASYNC
	select VIDEOBUF2_DMA_CONTIG
	select VIDEOBUF2_VMALLOC
	help
	  JPEG decode, encode and scaling through the UMS9117 VSP, and
	  camera capture through the shared DCAM when a camera input route
	  is enabled and a sensor is connected.
	  Select the input route matching the board's DCAM endpoint.

config VIDEO_UMS9117_DCAM_PARALLEL
	bool "UMS9117 parallel camera input"
	depends on VIDEO_UMS9117_JPEG
	select V4L2_FWNODE
	help
	  Capture NV16 frames through an 8-bit parallel camera input.
	  The DCAM endpoint describes the bus width and signal polarities.
	  Enable this in the board fragment when that route is connected.
	  The input route is checked before the capture device is registered.

config VIDEO_UMS9117_DCAM_SERIAL_G0
	bool "UMS9117 serial-G0 camera input"
	depends on VIDEO_UMS9117_JPEG
	help
	  Capture NV16 frames through a one-bit or two-bit serial-G0 camera input.
	  The DCAM endpoint declares sprd,serial-g0-data-width for this route.
	  Enable this in the board fragment when that route is connected.
	  The input route is checked before the capture device is registered.

config VIDEO_UMS9117_DCAM_SERIAL_G0_ONE_BIT
	bool "UMS9117 one-bit serial-G0 camera input"
	depends on VIDEO_UMS9117_DCAM_SERIAL_G0
	help
	  Capture 240x320 NV16 frames from a one-bit serial-G0 camera input.
	  The sensor must supply 240x320 YUYV pixels on this route.
	  The DCAM endpoint must declare a serial data width of one bit.
	  Enable this in the board fragment only when that input is connected.

config VIDEO_UMS9117_DCAM_SERIAL_G0_TWO_BIT
	bool "UMS9117 two-bit serial-G0 camera input"
	depends on VIDEO_UMS9117_DCAM_SERIAL_G0
	help
	  Capture 640x476 NV16 frames from a two-bit serial-G0 camera input.
	  The sensor must supply 640x476 YUYV pixels on this route.
	  The DCAM endpoint must declare a serial data width of two bits.
	  Enable this in the board fragment only when that input is connected.
```

## platforms/ums9117/target-template/linux/arch/arm/mach-ums9117/Kconfig.in
```kconfig
# SPDX-License-Identifier: GPL-2.0-only
if ARCH_UMS9117

config MACH_@SYMBOL@
	bool "@DEVICE@"
	select GPIOLIB
	select GPIO_PMIC_EIC_SPRD
	select MFD_SYSCON
	help
	  Board support for a UMS9117 feature phone that is loaded into RAM
	  over USB and started without a boot screen. The board provides the
	  USB session and read-only internal NAND access; it has no display,
	  keypad, audio or Bluetooth support.

endif
```

## targets/bq-2830l-tank-connect-max/linux/arch/arm/mach-ums9117/Kconfig
```kconfig
# SPDX-License-Identifier: GPL-2.0-only
if ARCH_UMS9117

config MACH_BQ_2830L_TANK_CONNECT_MAX
	bool "BQ 2830L Tank Connect Max"
	select GPIOLIB
	select GPIO_PMIC_EIC_SPRD
	select MFD_SYSCON
	help
	  Board support for a UMS9117 feature phone with 64 MiB of DRAM.
	  The phone has a 240x320 SPI panel and a matrix keypad.
	  BootROM/FDL USB loading starts a RAM system.
	  Internal NAND remains read-only.

endif
```

## targets/bq-2830l-tank-connect-max/linux/overlay/Documentation/devicetree/bindings/mfd/bq,2830l-radio-pins.yaml
```yaml
# SPDX-License-Identifier: GPL-2.0-only
%YAML 1.2
---
$id: http://devicetree.org/schemas/mfd/bq,2830l-radio-pins.yaml#
$schema: http://devicetree.org/meta-schemas/core.yaml#

title: BQ 2830L external radio pin-control registers

maintainers:
  - FPLinux contributors <313246064+fplinux-dev@users.noreply.github.com>

description:
  The external radio controller accesses the board pin-control registers through
  a syscon regmap.

allOf:
  - $ref: syscon-common.yaml#

properties:
  compatible:
    items:
      - const: bq,2830l-radio-pins
      - const: syscon

  reg:
    maxItems: 1

required:
  - compatible
  - reg

additionalProperties: false

examples:
  - |
    radio_pins: syscon@402a0000 {
        compatible = "bq,2830l-radio-pins", "syscon";
        reg = <0x402a0000 0x800>;
    };
...
```

## targets/bq-2830l-tank-connect-max/linux/overlay/Documentation/devicetree/bindings/net/wireless/bq,2830l-radio.yaml
```yaml
# SPDX-License-Identifier: GPL-2.0-only
%YAML 1.2
---
$id: http://devicetree.org/schemas/net/wireless/bq,2830l-radio.yaml#
$schema: http://devicetree.org/meta-schemas/core.yaml#

title: BQ 2830L external radio control

maintainers:
  - FPLinux contributors <313246064+fplinux-dev@users.noreply.github.com>

description:
  The board owns the power, reset and pin controls for its external radio and
  creates the child SDIO controller after powering the radio. Radio firmware,
  configuration and addresses are supplied through the firmware loader.

properties:
  compatible:
    const: bq,2830l-radio

  "#address-cells":
    const: 1

  "#size-cells":
    const: 1

  ranges: true

  bluetooth-config-name:
    description: Firmware-loader name of the Bluetooth configuration.
    $ref: /schemas/types.yaml#/definitions/string

  enable-gpios:
    description: Radio power-enable signal.
    maxItems: 1

  mac-address-name:
    description: Firmware-loader name of the six-byte WLAN MAC address.
    $ref: /schemas/types.yaml#/definitions/string

  reset-gpios:
    description: Radio reset signal.
    maxItems: 1

  rx-request-gpios:
    description: Radio packet receive-request signal.
    maxItems: 1

  wcn-supply:
    description: Radio supply.

  wifipa-supply:
    description: Radio power-amplifier supply.

  bq,pins:
    description: Phandle to the board pin-control registers.
    $ref: /schemas/types.yaml#/definitions/phandle

  sprd,aon-apb:
    description: Phandle to the always-on APB registers.
    $ref: /schemas/types.yaml#/definitions/phandle

patternProperties:
  "^mmc@[0-9a-f]+$":
    $ref: /schemas/mmc/sprd,ums9117-sdhci.yaml#

required:
  - compatible
  - "#address-cells"
  - "#size-cells"
  - ranges
  - enable-gpios
  - reset-gpios
  - rx-request-gpios
  - wcn-supply
  - wifipa-supply
  - bq,pins
  - sprd,aon-apb

additionalProperties: false

examples:
  - |
    #include <dt-bindings/clock/sprd,ums9117-clk.h>
    #include <dt-bindings/gpio/gpio.h>
    #include <dt-bindings/interrupt-controller/arm-gic.h>
    #include <dt-bindings/interrupt-controller/irq.h>
    #include <dt-bindings/reset/sprd,ums9117-reset.h>

    radio {
        compatible = "bq,2830l-radio";
        #address-cells = <1>;
        #size-cells = <1>;
        ranges;
        bluetooth-config-name = "ums9117/bq-2830l-tank-connect-max-wcn-bluetooth.bin";
        enable-gpios = <&ap_gpio 14 GPIO_ACTIVE_HIGH>;
        mac-address-name = "ums9117/bq-2830l-tank-connect-max-wcn-mac.bin";
        reset-gpios = <&ap_gpio 17 GPIO_ACTIVE_LOW>;
        rx-request-gpios = <&ap_gpio 13 GPIO_ACTIVE_HIGH>;
        wcn-supply = <&radio_wcn>;
        wifipa-supply = <&radio_wifipa>;
        bq,pins = <&radio_pins>;
        sprd,aon-apb = <&aon_apb>;

        mmc@20400000 {
            compatible = "sprd,ums9117-sdio";
            reg = <0x20400000 0x100>;
            #address-cells = <1>;
            #size-cells = <0>;
            bus-width = <1>;
            clocks = <&radio_sdio1_clk CLK_SDIO1>,
                     <&apahb_gate CLK_SDIO1_EB>;
            clock-names = "sdio", "enable";
            interrupts = <GIC_SPI 58 IRQ_TYPE_LEVEL_HIGH>;
            max-frequency = <13000000>;
            no-1-8-v;
            no-mmc;
            no-sd;
            non-removable;
            reg-names = "host";
            resets = <&apahb_reset RESET_SDIO1>;
            reset-names = "sdio";

            radio@1 {
                compatible = "sprd,marlin2-sdio";
                reg = <1>;
                calibration-name = "ums9117/bq-2830l-tank-connect-max-wcn-calibration.bin";
                firmware-name = "ums9117/bq-2830l-tank-connect-max-wcn.bin";
            };
        };
    };
...
```

## targets/bq-2830l-tank-connect-max/linux/overlay/drivers/mmc/host/bq2830l-radio/Kconfig
```kconfig
# SPDX-License-Identifier: GPL-2.0-only
config MMC_SDHCI_UMS9117_BQ_RADIO
	bool "BQ 2830L external radio SDIO"
	depends on MACH_BQ_2830L_TANK_CONNECT_MAX && MMC_SDHCI_UMS9117
	depends on REGULATOR_SC2731
	select REGULATOR_SC2720_WCN
	select REGULATOR_SC2720_WIFIPA
	select CRYPTO_LIB_SHA256
	help
	  Provide an on-demand, bounded RAM firmware boot for the board's
	  external radio through SDIO1. The boot attribute starts the operation
	  after the root filesystem is available; result reports firmware and
	  calibration readback, the ready event and restored board state.
	  The target's wireless, Bluetooth and FM options share this radio's
	  firmware, power and SDIO transport.

config BQ2830L_WLAN
	bool "BQ 2830L SDIO wireless networking"
	depends on MMC_SDHCI_UMS9117_BQ_RADIO
	depends on CFG80211 && INET
	help
	  Provide a single 2.4 GHz station or access-point interface using
	  board-supplied firmware, calibration and network address.

config BQ2830L_BLUETOOTH
	bool "BQ 2830L SDIO Bluetooth"
	depends on MMC_SDHCI_UMS9117_BQ_RADIO && BT=y
	help
	  Provide a native HCI controller using the shared external radio.
	  Start the prepared controller after root mount through
	  fplinux-bluetooth enable, then use BlueZ for adapter power.

config BQ2830L_FM
	bool "BQ 2830L SDIO FM receiver"
	depends on MMC_SDHCI_UMS9117_BQ_RADIO
	depends on VIDEO_DEV=y && MEDIA_RADIO_SUPPORT
	select UMS9117_FM_WIRE
	help
	  Provide a V4L2 FM receiver using the shared external radio.
	  The target's fitted audio route supplies the standard FM mixer.
```

## targets/inoi-240-modern-4g/kernel/Kconfig
```kconfig
# SPDX-License-Identifier: GPL-2.0-only
if ARCH_UMS9117

config MACH_INOI_240_MODERN_4G
	bool "INOI 240 Modern 4G"
	select GPIOLIB
	select GPIO_SC2720_EIC_UMS9117
	select MFD_SYSCON
	help
	  Board support for the INOI 240 Modern 4G, a UMS9117 feature
	  phone with a 128x160 NV3023 panel and matrix keypad. The target
	  supports RAM and removable microSD roots and relies on the fpdoom
	  bootstrap for the initial board pin state. Internal NAND is read-only.

endif
```

## targets/inoi-240-modern-4g/rootfs/defconfig
```kconfig
BR2_CCACHE=y
BR2_CCACHE_DIR="/cache/ccache"
BR2_GLOBAL_PATCH_DIR="$(BR2_EXTERNAL_FPLINUX_PATH)/patches"
BR2_DOWNLOAD_FORCE_CHECK_HASHES=y
BR2_REPRODUCIBLE=y
BR2_TARGET_GENERIC_HOSTNAME="inoi240"
BR2_TARGET_GENERIC_ISSUE="FPLinux INOI 240 RAM system"
BR2_INIT_NONE=y
BR2_ROOTFS_DEVICE_CREATION_DYNAMIC_DEVTMPFS=y
# BR2_TARGET_GENERIC_GETTY is not set
BR2_ROOTFS_OVERLAY="/workspace/common/rootfs/overlay /workspace/targets/inoi-240-modern-4g/rootfs/overlay"
BR2_ROOTFS_POST_BUILD_SCRIPT="/workspace/buildroot-external/post-build.sh"
BR2_PACKAGE_BUSYBOX=y
BR2_PACKAGE_FPLINUX_CONSOLE=y
BR2_PACKAGE_FPLINUX_INPUT=y
BR2_PACKAGE_FPLINUX_TYRQUAKE=y
BR2_TARGET_ROOTFS_CPIO=y
# BR2_TARGET_ROOTFS_TAR is not set
```

## targets/inoi-244-modern-4g/kernel/Kconfig
```kconfig
# SPDX-License-Identifier: GPL-2.0-only
if ARCH_UMS9117

config MACH_INOI_244_MODERN_4G
	bool "INOI 244 Modern 4G"
	select GPIOLIB
	select GPIO_SC2720_EIC_UMS9117
	select MFD_SYSCON
	help
	  Board support for the INOI 244 Modern 4G, a UMS9117 feature
	  phone with a 240x320 NV3030 panel and matrix keypad. Both RAM-root
	  and microSD-root boots rely on the fpdoom bootstrap for the board
	  pin state; Linux does not write the phone's flash storage.

endif
```
