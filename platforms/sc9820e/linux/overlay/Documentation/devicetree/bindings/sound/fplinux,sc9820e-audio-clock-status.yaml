## targets/inoi-244-modern-4g/rootfs/defconfig
```kconfig
BR2_CCACHE=y
BR2_CCACHE_DIR="/cache/ccache"
BR2_GLOBAL_PATCH_DIR="$(BR2_EXTERNAL_FPLINUX_PATH)/patches"
BR2_DOWNLOAD_FORCE_CHECK_HASHES=y
BR2_REPRODUCIBLE=y
BR2_TARGET_GENERIC_HOSTNAME="inoi244"
BR2_TARGET_GENERIC_ISSUE="FPLinux INOI 244 RAM system"
BR2_INIT_NONE=y
BR2_ROOTFS_DEVICE_CREATION_DYNAMIC_DEVTMPFS=y
# BR2_TARGET_GENERIC_GETTY is not set
BR2_ROOTFS_OVERLAY="/workspace/common/rootfs/overlay /workspace/targets/inoi-244-modern-4g/rootfs/overlay"
BR2_ROOTFS_POST_BUILD_SCRIPT="/workspace/buildroot-external/post-build.sh"
BR2_PACKAGE_BUSYBOX=y
BR2_PACKAGE_FPLINUX_CONSOLE=y
BR2_TARGET_ROOTFS_CPIO=y
# BR2_TARGET_ROOTFS_TAR is not set
```

## targets/maxvi-k15n-4g/linux/arch/arm/mach-ums9117/Kconfig
```kconfig
# SPDX-License-Identifier: GPL-2.0-only
if ARCH_UMS9117

config MACH_MAXVI_K15N_4G
	bool "Maxvi K15n4G"
	select GPIOLIB
	select GPIO_PMIC_EIC_SPRD
	select MFD_SYSCON
	help
	  Board support for the Maxvi K15n4G, a UMS9117 feature phone.
	  USB loading runs a temporary RAM system with read-only internal
	  NAND access. The board profile selects the LCM/DBI display,
	  matrix keypad and SC2720 PMIC input for the power key.

endif
```

## targets/nokia-110-4g/linux/arch/arm/mach-ums9117/Kconfig
```kconfig
# SPDX-License-Identifier: GPL-2.0-only
if ARCH_UMS9117

config MACH_NOKIA_110_4G
	bool "Nokia 110 4G"
	select GPIOLIB
	select GPIO_PMIC_EIC_SPRD
	select MFD_SYSCON
	help
	  Board support for the UMS9117-based Nokia 110 4G.
	  The board's Devicetree selects its display and keypad wiring.
	  The USB loader starts Linux without writing internal storage.
	  Internal NAND is available through a read-only backup interface.

endif
```
