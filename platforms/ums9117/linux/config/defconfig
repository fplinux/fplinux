## targets/konrow-senior-280-plus/linux/fragments/arch/arm/mach-ums9117/Kconfig
```kconfig
# SPDX-License-Identifier: GPL-2.0-only
if ARCH_UMS9117

config MACH_KONROW_SENIOR_280_PLUS
	bool "Konrow Senior 280 Plus"
	select GPIOLIB
	select GPIO_PMIC_EIC_SPRD
	select MFD_SYSCON
	help
	  Board support for the Konrow Senior 280 Plus, loaded into RAM
	  over USB with a 48 MiB memory layout. The board provides a USB
	  session, LCM display, matrix keypad, fixed-session microSD access,
	  headphone playback, battery measurements and parallel NAND identification.
	  Internal storage reads, speaker playback and Bluetooth are not enabled.

endif
```

## targets/konrow-senior-280-plus/linux/overlay/Documentation/devicetree/bindings/display/fplinux,ums9117-konrow-senior-280-plus-lcm-fb.yaml
```yaml
# SPDX-License-Identifier: GPL-2.0-only
%YAML 1.2
---
$id: http://devicetree.org/schemas/display/fplinux,ums9117-konrow-senior-280-plus-lcm-fb.yaml#
$schema: http://devicetree.org/meta-schemas/core.yaml#

title: Konrow Senior 280 Plus UMS9117 LCDC display

maintainers:
  - FPLinux contributors <313246064+fplinux-dev@users.noreply.github.com>

description: |
  The DBI display uses PWM to vary brightness on a single white WLED channel
  with a fixed current.

allOf:
  - $ref: /schemas/display/fplinux,ums9117-fb-common.yaml#

properties:
  compatible:
    const: fplinux,ums9117-konrow-senior-280-plus-lcm-fb

  reg: true

  reg-names:
    contains:
      const: lcm-data

  sprd,wled-current-levels:
    items:
      - const: 0
      - const: 0
      - const: 0
      - minimum: 1
        maximum: 63
    description: Fixed current of the white channel. RGB channels are off.

  sprd,wled-default-level:
    minimum: 1
    maximum: 255
    description: Initial PWM duty.

required:
  - compatible

unevaluatedProperties: false
```

## targets/nokia-110-4g/linux/overlay/Documentation/devicetree/bindings/media/i2c/nokia,110-4g-bf30a2.yaml
```yaml
# SPDX-License-Identifier: (GPL-2.0-only OR BSD-2-Clause)
%YAML 1.2
---
$id: http://devicetree.org/schemas/media/i2c/nokia,110-4g-bf30a2.yaml#
$schema: http://devicetree.org/meta-schemas/core.yaml#

title: Nokia 110 4G BF30A2 camera

maintainers:
  - FPLinux contributors <313246064+fplinux-dev@users.noreply.github.com>

allOf:
  - $ref: /schemas/media/i2c/byd,bf30a2-common.yaml#

properties:
  compatible:
    const: nokia,110-4g-bf30a2

  front-powerdown-gpios:
    maxItems: 1
    description: Additional board camera control line.

required:
  - compatible
  - front-powerdown-gpios

unevaluatedProperties: false
```
