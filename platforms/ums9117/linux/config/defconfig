## platforms/ums9117/linux/config/defconfig
```kconfig
CONFIG_LOCALVERSION="-fplinux"
# CONFIG_LOCALVERSION_AUTO is not set
CONFIG_KERNEL_XZ=y
CONFIG_DEFAULT_HOSTNAME="fplinux"
CONFIG_SYSVIPC=y
CONFIG_PREEMPT_NONE=y
CONFIG_HIGH_RES_TIMERS=y
CONFIG_NO_HZ_IDLE=y
CONFIG_BLK_DEV_INITRD=y
CONFIG_INITRAMFS_COMPRESSION_XZ=y
# CONFIG_RD_GZIP is not set
# CONFIG_RD_BZIP2 is not set
# CONFIG_RD_LZMA is not set
# CONFIG_RD_LZO is not set
# CONFIG_RD_LZ4 is not set
# CONFIG_RD_ZSTD is not set
# CONFIG_XZ_DEC_X86 is not set
# CONFIG_XZ_DEC_POWERPC is not set
# CONFIG_XZ_DEC_ARM is not set
# CONFIG_XZ_DEC_ARMTHUMB is not set
# CONFIG_XZ_DEC_ARM64 is not set
# CONFIG_XZ_DEC_SPARC is not set
# CONFIG_XZ_DEC_RISCV is not set
CONFIG_SWAP=y
CONFIG_ZRAM=y
CONFIG_ZRAM_BACKEND_LZO=y
CONFIG_ZRAM_BACKEND_ZSTD=y
CONFIG_ZRAM_DEF_COMP_ZSTD=y
CONFIG_BLK_DEV_LOOP=y
CONFIG_CC_OPTIMIZE_FOR_SIZE=y
CONFIG_LD_DEAD_CODE_DATA_ELIMINATION=y
CONFIG_EXPERT=y
# CONFIG_FHANDLE is not set
CONFIG_POSIX_TIMERS=y
# CONFIG_AIO is not set
# CONFIG_IO_URING is not set
# CONFIG_ADVISE_SYSCALLS is not set
# CONFIG_MEMBARRIER is not set
# CONFIG_RSEQ is not set
# CONFIG_CACHESTAT_SYSCALL is not set
CONFIG_ARCH_UMS9117=y
CONFIG_MACH_BQ_2830L_TANK_CONNECT_MAX=y
CONFIG_MACH_INOI_240_MODERN_4G=y
CONFIG_MACH_INOI_244_MODERN_4G=y
CONFIG_MACH_ITEL_NEO_R60_PLUS=y
CONFIG_MACH_KONROW_SENIOR_280_PLUS=y
CONFIG_MACH_MAXVI_K15N_4G=y
CONFIG_MACH_NOKIA_110_4G=y
CONFIG_MACH_NOKIA_TA1618=y
CONFIG_MACH_UNIWA_V1000_4G=y
CONFIG_THUMB2_KERNEL=y
# CONFIG_ATAGS is not set
CONFIG_VFP=y
CONFIG_NEON=y
CONFIG_CPU_FREQ=y
CONFIG_CPU_FREQ_DEFAULT_GOV_PERFORMANCE=y
CONFIG_CPU_FREQ_GOV_USERSPACE=y
CONFIG_CPUFREQ_DT=y
CONFIG_SUSPEND=y
CONFIG_SECCOMP=y
CONFIG_SECCOMP_FILTER=y
# CONFIG_STACKPROTECTOR is not set
CONFIG_PARTITION_ADVANCED=y
CONFIG_MQ_IOSCHED_DEADLINE=y
# CONFIG_MQ_IOSCHED_KYBER is not set
# CONFIG_IOSCHED_BFQ is not set
# CONFIG_COREDUMP is not set
CONFIG_SLUB_TINY=y
# CONFIG_COMPAT_BRK is not set
# CONFIG_VM_EVENT_COUNTERS is not set
CONFIG_CMA=y
CONFIG_NET=y
CONFIG_PACKET=y
CONFIG_INET=y
CONFIG_UNIX=y
CONFIG_BT=y
CONFIG_BT_BREDR=y
CONFIG_BT_RFCOMM=y
CONFIG_BT_BNEP=y
CONFIG_BT_HIDP=y
CONFIG_BT_UMS9117_CM4=y
# CONFIG_IPV6 is not set
CONFIG_DEVTMPFS=y
CONFIG_DEVTMPFS_MOUNT=y
# CONFIG_STANDALONE is not set
# CONFIG_PREVENT_FIRMWARE_BUILD is not set
CONFIG_FW_LOADER=y
CONFIG_FW_LOADER_COMPRESS=y
CONFIG_FW_LOADER_COMPRESS_XZ=y
CONFIG_MAILBOX=y
CONFIG_BT_HCIUART=y
# CONFIG_ALLOW_DEV_COREDUMP is not set
CONFIG_NETDEVICES=y
CONFIG_WIRELESS=y
CONFIG_WLAN=y
CONFIG_CFG80211=y
CONFIG_BQ2830L_WLAN=y
CONFIG_BQ2830L_BLUETOOTH=y
CONFIG_BQ2830L_FM=y
CONFIG_INPUT_EVDEV=y
# CONFIG_KEYBOARD_ATKBD is not set
CONFIG_KEYBOARD_UMS9117=y
CONFIG_KEYBOARD_UMS9117_AUX_EIC_KEY=y
# CONFIG_INPUT_MOUSE is not set
CONFIG_INPUT_MISC=y
CONFIG_INPUT_UINPUT=y
CONFIG_INPUT_SC27XX_VIBRA=y
# CONFIG_SERIO is not set
# CONFIG_LEGACY_PTYS is not set
# CONFIG_HW_RANDOM is not set
# CONFIG_DEVPORT is not set
# CONFIG_GPIO_CDEV is not set
CONFIG_GPIO_SPRD=y
CONFIG_GPIO_EIC_SPRD=y
CONFIG_I2C=y
CONFIG_I2C_CHARDEV=y
CONFIG_I2C_SPRD=y
CONFIG_POWER_RESET=y
CONFIG_POWER_RESET_SC2720_UMS9117=y
CONFIG_POWER_SUPPLY=y
CONFIG_POWER_SUPPLY_SC2720_CHARGER_UMS9117=y
CONFIG_POWER_SUPPLY_SC2720_FGU_UMS9117=y
# CONFIG_HWMON is not set
CONFIG_THERMAL=y
CONFIG_THERMAL_OF=y
CONFIG_SPRD_THERMAL=y
CONFIG_REGULATOR=y
CONFIG_REGULATOR_SC2731=y
CONFIG_MEDIA_SUPPORT=y
CONFIG_MEDIA_SUPPORT_FILTER=y
# CONFIG_MEDIA_SUBDRV_AUTOSELECT is not set
CONFIG_MEDIA_CAMERA_SUPPORT=y
CONFIG_MEDIA_PLATFORM_SUPPORT=y
CONFIG_MEDIA_RADIO_SUPPORT=y
# CONFIG_MEDIA_TUNER_E4000 is not set
# CONFIG_MEDIA_TUNER_FC0011 is not set
# CONFIG_MEDIA_TUNER_FC0012 is not set
# CONFIG_MEDIA_TUNER_FC0013 is not set
# CONFIG_MEDIA_TUNER_FC2580 is not set
# CONFIG_MEDIA_TUNER_IT913X is not set
# CONFIG_MEDIA_TUNER_M88RS6000T is not set
# CONFIG_MEDIA_TUNER_MAX2165 is not set
# CONFIG_MEDIA_TUNER_MC44S803 is not set
# CONFIG_MEDIA_TUNER_MSI001 is not set
# CONFIG_MEDIA_TUNER_MT2060 is not set
# CONFIG_MEDIA_TUNER_MT2063 is not set
# CONFIG_MEDIA_TUNER_MT20XX is not set
# CONFIG_MEDIA_TUNER_MT2131 is not set
# CONFIG_MEDIA_TUNER_MT2266 is not set
# CONFIG_MEDIA_TUNER_MXL301RF is not set
# CONFIG_MEDIA_TUNER_MXL5005S is not set
# CONFIG_MEDIA_TUNER_MXL5007T is not set
# CONFIG_MEDIA_TUNER_QM1D1B0004 is not set
# CONFIG_MEDIA_TUNER_QM1D1C0042 is not set
# CONFIG_MEDIA_TUNER_QT1010 is not set
# CONFIG_MEDIA_TUNER_R820T is not set
# CONFIG_MEDIA_TUNER_SI2157 is not set
# CONFIG_MEDIA_TUNER_SIMPLE is not set
# CONFIG_MEDIA_TUNER_TDA18212 is not set
# CONFIG_MEDIA_TUNER_TDA18218 is not set
# CONFIG_MEDIA_TUNER_TDA18250 is not set
# CONFIG_MEDIA_TUNER_TDA18271 is not set
# CONFIG_MEDIA_TUNER_TDA827X is not set
# CONFIG_MEDIA_TUNER_TDA8290 is not set
# CONFIG_MEDIA_TUNER_TDA9887 is not set
# CONFIG_MEDIA_TUNER_TEA5761 is not set
# CONFIG_MEDIA_TUNER_TEA5767 is not set
# CONFIG_MEDIA_TUNER_TUA9001 is not set
# CONFIG_MEDIA_TUNER_XC2028 is not set
# CONFIG_MEDIA_TUNER_XC4000 is not set
# CONFIG_MEDIA_TUNER_XC5000 is not set
CONFIG_RADIO_UMS9117_CM4=y
CONFIG_V4L_MEM2MEM_DRIVERS=y
CONFIG_VIDEO_UMS9117_ROTA=y
CONFIG_VIDEO_UMS9117_JPEG=y
CONFIG_VIDEO_BF20A6=y
CONFIG_VIDEO_BF30A2=y
CONFIG_VIDEO_GC032A=y
CONFIG_VIDEO_GC2145=y
CONFIG_VIDEO_UMS9117_DCAM_PARALLEL=y
CONFIG_VIDEO_UMS9117_DCAM_SERIAL_G0=y
CONFIG_VIDEO_UMS9117_DCAM_SERIAL_G0_ONE_BIT=y
CONFIG_VIDEO_UMS9117_DCAM_SERIAL_G0_TWO_BIT=y
CONFIG_VIDEO_V4L2_SUBDEV_API=y
CONFIG_DRM=y
CONFIG_DRM_BQ2830L=y
CONFIG_DRM_INOI240=y
CONFIG_DRM_INOI244=y
CONFIG_DRM_ITEL_NEO_R60_PLUS=y
CONFIG_DRM_KONROW_SENIOR_280_PLUS=y
CONFIG_DRM_MAXVI_K15N_4G=y
CONFIG_DRM_NOKIA110=y
CONFIG_DRM_TA1618=y
CONFIG_DRM_UNIWA_V1000=y
CONFIG_FB=y
CONFIG_FRAMEBUFFER_CONSOLE=y
CONFIG_FRAMEBUFFER_CONSOLE_DETECT_PRIMARY=y
CONFIG_FONTS=y
CONFIG_FONT_6x8=y
CONFIG_FONT_7x14=y
CONFIG_SOUND=y
CONFIG_SND=y
CONFIG_SND_UMS9117=y
CONFIG_SND_UMS9117_SPEAKER_VIBRATOR=y
CONFIG_SND_UMS9117_HEADPHONE_FED_SPEAKER=y
CONFIG_HID=y
CONFIG_HID_GENERIC=y
CONFIG_UHID=y
CONFIG_USB_MUSB_HDRC=y
CONFIG_USB_MUSB_UMS9117=y
CONFIG_USB_MUSB_UMS9117_COLD=y
CONFIG_USB_MUSB_UMS9117_INHERITED=y
CONFIG_MUSB_PIO_ONLY=y
CONFIG_USB_GADGET=y
CONFIG_USB_CONFIGFS=y
CONFIG_USB_CONFIGFS_SERIAL=y
CONFIG_USB_CONFIGFS_NCM=y
CONFIG_USB_CONFIGFS_RNDIS=y
CONFIG_MMC=y
CONFIG_MMC_REMOVABLE=y
CONFIG_MMC_GPIO=y
CONFIG_MMC_SDHCI=y
CONFIG_MMC_SDHCI_PLTFM=y
CONFIG_MMC_SDHCI_UMS9117=y
CONFIG_MMC_SDHCI_UMS9117_BQ_RADIO=y
# CONFIG_PWRSEQ_EMMC is not set
# CONFIG_PWRSEQ_SIMPLE is not set
CONFIG_NEW_LEDS=y
CONFIG_LEDS_CLASS=y
CONFIG_LEDS_SC2720_KPLED_UMS9117=y
CONFIG_LEDS_TRIGGERS=y
CONFIG_LEDS_TRIGGER_INPUT_EVENTS=y
CONFIG_RTC_CLASS=y
# CONFIG_RTC_HCTOSYS is not set
# CONFIG_RTC_SYSTOHC is not set
# CONFIG_RTC_NVMEM is not set
CONFIG_RTC_DRV_SC27XX=y
CONFIG_DMADEVICES=y
CONFIG_SPRD_DMA=y
CONFIG_DMA_CMA=y
CONFIG_CMA_SIZE_MBYTES=0
# CONFIG_VIRTIO_MENU is not set
# CONFIG_VHOST_MENU is not set
CONFIG_SPRD_UMS9117_INHERITED_CLK=y
CONFIG_COMMON_CLK=y
CONFIG_SPRD_COMMON_CLK=y
CONFIG_SPRD_UMS9117_CLK=y
CONFIG_COMMON_CLK_SC2720=y
CONFIG_RESET_UMS9117=y
CONFIG_UMS9117_NANDC_RO=y
CONFIG_HWSPINLOCK=y
CONFIG_HWSPINLOCK_SPRD=y
CONFIG_SPI=y
CONFIG_SPI_SPRD_ADI=y
CONFIG_MFD_SC27XX_PMIC=y
CONFIG_NVMEM=y
CONFIG_NVMEM_SC27XX_EFUSE=y
CONFIG_NVMEM_SPRD_EFUSE=y
CONFIG_PINCTRL=y
CONFIG_PINCTRL_SINGLE=y
CONFIG_IIO=y
CONFIG_SC27XX_ADC=y
# CONFIG_DNOTIFY is not set
CONFIG_INOTIFY_USER=y
CONFIG_VFAT_FS=y
CONFIG_EXT4_FS=y
CONFIG_TMPFS=y
CONFIG_TMPFS_XATTR=y
CONFIG_TMPFS_POSIX_ACL=y
CONFIG_MISC_FILESYSTEMS=y
CONFIG_SQUASHFS=y
CONFIG_SQUASHFS_XATTR=y
CONFIG_SQUASHFS_FILE_DIRECT=y
CONFIG_SQUASHFS_COMPILE_DECOMP_SINGLE=y
CONFIG_SQUASHFS_XZ=y
# CONFIG_SQUASHFS_ZLIB is not set
# CONFIG_SQUASHFS_LZO is not set
# CONFIG_SQUASHFS_ZSTD is not set
# CONFIG_SQUASHFS_LZ4 is not set
# CONFIG_SQUASHFS_COMP_CACHE_FULL is not set
# CONFIG_SQUASHFS_FILE_CACHE is not set
# CONFIG_SQUASHFS_CHOICE_DECOMP_BY_MOUNT is not set
# CONFIG_SQUASHFS_COMPILE_DECOMP_MULTI is not set
# CONFIG_SQUASHFS_COMPILE_DECOMP_MULTI_PERCPU is not set
# CONFIG_SQUASHFS_MOUNT_DECOMP_THREADS is not set
CONFIG_OVERLAY_FS=y
# CONFIG_OVERLAY_FS_INDEX is not set
# CONFIG_OVERLAY_FS_REDIRECT_DIR is not set
# CONFIG_OVERLAY_FS_XINO_AUTO is not set
CONFIG_NLS_CODEPAGE_437=y
CONFIG_NLS_ISO8859_1=y
# CONFIG_CRC_OPTIMIZATIONS is not set
CONFIG_PRINTK_TIME=y
# CONFIG_SYMBOLIC_ERRNAME is not set
# CONFIG_DEBUG_MISC is not set
# CONFIG_SECTION_MISMATCH_WARN_ONLY is not set
# CONFIG_RUNTIME_TESTING_MENU is not set
```

## platforms/ums9117/linux/overlay/Documentation/devicetree/bindings/display/fplinux,ums9117-fb.yaml
```yaml
# SPDX-License-Identifier: GPL-2.0-only
%YAML 1.2
---
$id: http://devicetree.org/schemas/display/fplinux,ums9117-fb.yaml#
$schema: http://devicetree.org/meta-schemas/core.yaml#

title: UMS9117 LCDC display with current-controlled backlight

maintainers:
  - FPLinux contributors <313246064+fplinux-dev@users.noreply.github.com>

description: |
  Enabled backlight channels use equal nonzero current codes. Brightness
  varies those codes, up to the declared current of an enabled channel.

allOf:
  - $ref: fplinux,ums9117-fb-common.yaml#
  - if:
      properties:
        compatible:
          enum:
            - fplinux,ums9117-nv3030-lcm-fb
            - fplinux,ums9117-nv3023-lcm-fb
            - fplinux,ums9117-gc9307-lcm-fb
    then:
      properties:
        reg-names:
          contains:
            const: lcm-data
    else:
      properties:
        reg-names:
          contains:
            const: spi

properties:
  compatible:
    enum:
      - fplinux,ums9117-st7789p3-spi-fb
      - fplinux,ums9117-st7789h2-spi-fb
      - fplinux,ums9117-gc9307-spi-fb
      - fplinux,ums9117-uniwa-v1000-spi-fb
      - fplinux,ums9117-nokia110-spi-fb
      - fplinux,ums9117-nv3030-lcm-fb
      - fplinux,ums9117-nv3023-lcm-fb
      - fplinux,ums9117-gc9307-lcm-fb

  sprd,wled-default-level:
    maximum: 63
    description: Initial backlight current code.

required:
  - compatible

unevaluatedProperties: false
```

## platforms/ums9117/linux/overlay/Documentation/devicetree/bindings/media/i2c/byd,bf30a2-common.yaml
```yaml
# SPDX-License-Identifier: (GPL-2.0-only OR BSD-2-Clause)
%YAML 1.2
---
$id: http://devicetree.org/schemas/media/i2c/byd,bf30a2-common.yaml#
$schema: http://devicetree.org/meta-schemas/core.yaml#

title: Common properties for BF30A2 and BF3A01 CMOS image sensors

maintainers:
  - FPLinux contributors <313246064+fplinux-dev@users.noreply.github.com>

select: false

properties:
  reg:
    const: 0x6e

  clocks:
    maxItems: 1

  clock-names:
    const: xclk

  avdd-supply: true
  iovdd-supply: true

  reset-gpios:
    maxItems: 1

  powerdown-gpios:
    maxItems: 1

  pinctrl-names:
    const: default

  pinctrl-0: true

  rotation:
    $ref: /schemas/media/video-interface-devices.yaml#/properties/rotation

  port:
    $ref: /schemas/graph.yaml#/$defs/port-base
    additionalProperties: false
    properties:
      endpoint:
        $ref: /schemas/graph.yaml#/$defs/endpoint-base
        unevaluatedProperties: false
        properties:
          sprd,serial-g0-data-width:
            const: 1
            description: One data line on the UMS9117 serial G0 camera input.
        required:
          - remote-endpoint
          - sprd,serial-g0-data-width
    required:
      - endpoint

required:
  - reg
  - clocks
  - clock-names
  - avdd-supply
  - iovdd-supply
  - reset-gpios
  - powerdown-gpios
  - port

additionalProperties: true
```

## platforms/ums9117/linux/overlay/Documentation/devicetree/bindings/media/i2c/byd,bf30a2.yaml
```yaml
# SPDX-License-Identifier: (GPL-2.0-only OR BSD-2-Clause)
%YAML 1.2
---
$id: http://devicetree.org/schemas/media/i2c/byd,bf30a2.yaml#
$schema: http://devicetree.org/meta-schemas/core.yaml#

title: BF30A2 and BF3A01 CMOS image sensors

maintainers:
  - FPLinux contributors <313246064+fplinux-dev@users.noreply.github.com>

allOf:
  - $ref: byd,bf30a2-common.yaml#

properties:
  compatible:
    enum:
      - byd,bf30a2
      - byd,bf3a01

  camera-core-supply: true

required:
  - compatible
  - camera-core-supply

unevaluatedProperties: false
```

## platforms/ums9117/linux/overlay/drivers/mmc/host/marlin2/Kconfig
```kconfig
# SPDX-License-Identifier: GPL-2.0-only
config MARLIN2_SDIO
	bool "UMS9117 external Marlin2 radio"
	depends on MMC_SDHCI_UMS9117
	depends on REGULATOR_SC2731
	select REGULATOR_SC2720_WCN
	select REGULATOR_SC2720_WIFIPA
	select CRYPTO_LIB_SHA256
	help
	  Provide an on-demand, bounded RAM firmware boot for the board's
	  external radio through SDIO1. Load the board's firmware and
	  calibration from the root filesystem when a consumer starts.
	  Wi-Fi, Bluetooth and FM share this radio's firmware, power and SDIO
	  transport.

config MARLIN2_WLAN
	bool "Marlin2 SDIO wireless networking"
	depends on MARLIN2_SDIO
	depends on CFG80211 && INET
	help
	  Provide a single 2.4 GHz station or access-point interface using
	  board-supplied firmware, calibration and network address.

config MARLIN2_BLUETOOTH
	bool "Marlin2 SDIO Bluetooth"
	depends on MARLIN2_SDIO && BT=y
	help
	  Provide a native HCI controller using the shared external radio.
	  Start the prepared controller after root mount through
	  fplinux-bluetooth enable, then use BlueZ for adapter power.

config MARLIN2_FM
	bool "Marlin2 SDIO FM receiver"
	depends on MARLIN2_SDIO
	depends on VIDEO_DEV=y && MEDIA_RADIO_SUPPORT
	select UMS9117_FM_WIRE
	help
	  Provide a V4L2 FM receiver using the shared external radio.
	  The target's fitted audio route supplies the standard FM mixer.
```

## targets/bq-2830l-tank-connect-max/linux/overlay/drivers/mmc/host/bq2830l-radio/Kconfig
```kconfig
# SPDX-License-Identifier: GPL-2.0-only
config MMC_SDHCI_UMS9117_BQ_RADIO
	bool "UMS9117 external Marlin2 radio"
	depends on MACH_BQ_2830L_TANK_CONNECT_MAX || MACH_ITEL_NEO_R60_PLUS
	depends on MMC_SDHCI_UMS9117
	depends on REGULATOR_SC2731
	select REGULATOR_SC2720_WCN
	select REGULATOR_SC2720_WIFIPA
	select CRYPTO_LIB_SHA256
	help
	  Provide an on-demand, bounded RAM firmware boot for the board's
	  external radio through SDIO1. Load the board's firmware and
	  calibration from the root filesystem when a consumer starts.
	  Wi-Fi and Bluetooth share this radio's firmware, power and SDIO
	  transport. The BQ 2830L also uses this radio for FM.

config BQ2830L_WLAN
	bool "Marlin2 SDIO wireless networking"
	depends on MMC_SDHCI_UMS9117_BQ_RADIO
	depends on CFG80211 && INET
	help
	  Provide a single 2.4 GHz station or access-point interface using
	  board-supplied firmware, calibration and network address.

config BQ2830L_BLUETOOTH
	bool "Marlin2 SDIO Bluetooth"
	depends on MMC_SDHCI_UMS9117_BQ_RADIO && BT=y
	help
	  Provide a native HCI controller using the shared external radio.
	  Start the prepared controller after root mount through
	  fplinux-bluetooth enable, then use BlueZ for adapter power.

config BQ2830L_FM
	bool "BQ 2830L SDIO FM receiver"
	depends on MMC_SDHCI_UMS9117_BQ_RADIO
	depends on MACH_BQ_2830L_TANK_CONNECT_MAX
	depends on VIDEO_DEV=y && MEDIA_RADIO_SUPPORT
	select UMS9117_FM_WIRE
	help
	  Provide a V4L2 FM receiver using the shared external radio.
	  The target's fitted audio route supplies the standard FM mixer.
```

## targets/itel-neo-r60-plus/linux/fragments/arch/arm/mach-ums9117/Kconfig
```kconfig
# SPDX-License-Identifier: GPL-2.0-only
if ARCH_UMS9117

config MACH_ITEL_NEO_R60_PLUS
	bool "itel Neo R60+"
	select GPIOLIB
	select GPIO_PMIC_EIC_SPRD
	select MFD_SYSCON
	help
	  Board support for the UMS9117-based itel Neo R60+.
	  Includes the 240x320 SPI display and physical matrix keypad.
	  Linux is loaded into RAM over USB and provides USB network access.
	  The raw internal NAND device is available for read-only access.

endif
```
