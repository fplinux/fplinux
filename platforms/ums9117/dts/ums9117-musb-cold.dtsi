// SPDX-License-Identifier: GPL-2.0-only

/*
 * Cold-owned UMS9117 MUSB resources.  Targets include this profile only when
 * Linux, rather than the RAM loader handoff, owns the USB controller setup.
 * The target supplies its own USB regulator and enables the peripheral mode.
 */

&usb {
	compatible = "fplinux,ums9117-musb";
	reg = <0x20200000 0x00002000>,
	      <0x20e00000 0x00004000>,
	      <0x40430000 0x00003000>,
	      <0x403e0000 0x00003000>;
	reg-names = "musb", "ap-ahb", "anlg-phy-g8", "anlg-phy-top";
	sprd,aon-apb = <&aon_apb>;
};
